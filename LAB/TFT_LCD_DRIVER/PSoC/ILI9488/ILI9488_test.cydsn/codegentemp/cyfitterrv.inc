    IF :LNOT::DEF:INCLUDED_CYFITTERRV_INC
INCLUDED_CYFITTERRV_INC EQU 1
    GET cydevicerv_trm.inc

; DATA
DATA__0__DM__MASK EQU 0x07
DATA__0__DM__SHIFT EQU 0
DATA__0__DR EQU CYREG_PRT1_DR
DATA__0__HSIOM EQU CYREG_HSIOM_PORT_SEL1
DATA__0__HSIOM_MASK EQU 0x0000000F
DATA__0__HSIOM_SHIFT EQU 0
DATA__0__INTCFG EQU CYREG_PRT1_INTCFG
DATA__0__INTSTAT EQU CYREG_PRT1_INTSTAT
DATA__0__MASK EQU 0x01
DATA__0__PA__CFG0 EQU CYREG_UDB_PA1_CFG0
DATA__0__PA__CFG1 EQU CYREG_UDB_PA1_CFG1
DATA__0__PA__CFG10 EQU CYREG_UDB_PA1_CFG10
DATA__0__PA__CFG11 EQU CYREG_UDB_PA1_CFG11
DATA__0__PA__CFG12 EQU CYREG_UDB_PA1_CFG12
DATA__0__PA__CFG13 EQU CYREG_UDB_PA1_CFG13
DATA__0__PA__CFG14 EQU CYREG_UDB_PA1_CFG14
DATA__0__PA__CFG2 EQU CYREG_UDB_PA1_CFG2
DATA__0__PA__CFG3 EQU CYREG_UDB_PA1_CFG3
DATA__0__PA__CFG4 EQU CYREG_UDB_PA1_CFG4
DATA__0__PA__CFG5 EQU CYREG_UDB_PA1_CFG5
DATA__0__PA__CFG6 EQU CYREG_UDB_PA1_CFG6
DATA__0__PA__CFG7 EQU CYREG_UDB_PA1_CFG7
DATA__0__PA__CFG8 EQU CYREG_UDB_PA1_CFG8
DATA__0__PA__CFG9 EQU CYREG_UDB_PA1_CFG9
DATA__0__PC EQU CYREG_PRT1_PC
DATA__0__PC2 EQU CYREG_PRT1_PC2
DATA__0__PORT EQU 1
DATA__0__PS EQU CYREG_PRT1_PS
DATA__0__SHIFT EQU 0
DATA__1__DM__MASK EQU 0x38
DATA__1__DM__SHIFT EQU 3
DATA__1__DR EQU CYREG_PRT1_DR
DATA__1__HSIOM EQU CYREG_HSIOM_PORT_SEL1
DATA__1__HSIOM_MASK EQU 0x000000F0
DATA__1__HSIOM_SHIFT EQU 4
DATA__1__INTCFG EQU CYREG_PRT1_INTCFG
DATA__1__INTSTAT EQU CYREG_PRT1_INTSTAT
DATA__1__MASK EQU 0x02
DATA__1__PA__CFG0 EQU CYREG_UDB_PA1_CFG0
DATA__1__PA__CFG1 EQU CYREG_UDB_PA1_CFG1
DATA__1__PA__CFG10 EQU CYREG_UDB_PA1_CFG10
DATA__1__PA__CFG11 EQU CYREG_UDB_PA1_CFG11
DATA__1__PA__CFG12 EQU CYREG_UDB_PA1_CFG12
DATA__1__PA__CFG13 EQU CYREG_UDB_PA1_CFG13
DATA__1__PA__CFG14 EQU CYREG_UDB_PA1_CFG14
DATA__1__PA__CFG2 EQU CYREG_UDB_PA1_CFG2
DATA__1__PA__CFG3 EQU CYREG_UDB_PA1_CFG3
DATA__1__PA__CFG4 EQU CYREG_UDB_PA1_CFG4
DATA__1__PA__CFG5 EQU CYREG_UDB_PA1_CFG5
DATA__1__PA__CFG6 EQU CYREG_UDB_PA1_CFG6
DATA__1__PA__CFG7 EQU CYREG_UDB_PA1_CFG7
DATA__1__PA__CFG8 EQU CYREG_UDB_PA1_CFG8
DATA__1__PA__CFG9 EQU CYREG_UDB_PA1_CFG9
DATA__1__PC EQU CYREG_PRT1_PC
DATA__1__PC2 EQU CYREG_PRT1_PC2
DATA__1__PORT EQU 1
DATA__1__PS EQU CYREG_PRT1_PS
DATA__1__SHIFT EQU 1
DATA__2__DM__MASK EQU 0x1C0
DATA__2__DM__SHIFT EQU 6
DATA__2__DR EQU CYREG_PRT1_DR
DATA__2__HSIOM EQU CYREG_HSIOM_PORT_SEL1
DATA__2__HSIOM_MASK EQU 0x00000F00
DATA__2__HSIOM_SHIFT EQU 8
DATA__2__INTCFG EQU CYREG_PRT1_INTCFG
DATA__2__INTSTAT EQU CYREG_PRT1_INTSTAT
DATA__2__MASK EQU 0x04
DATA__2__PA__CFG0 EQU CYREG_UDB_PA1_CFG0
DATA__2__PA__CFG1 EQU CYREG_UDB_PA1_CFG1
DATA__2__PA__CFG10 EQU CYREG_UDB_PA1_CFG10
DATA__2__PA__CFG11 EQU CYREG_UDB_PA1_CFG11
DATA__2__PA__CFG12 EQU CYREG_UDB_PA1_CFG12
DATA__2__PA__CFG13 EQU CYREG_UDB_PA1_CFG13
DATA__2__PA__CFG14 EQU CYREG_UDB_PA1_CFG14
DATA__2__PA__CFG2 EQU CYREG_UDB_PA1_CFG2
DATA__2__PA__CFG3 EQU CYREG_UDB_PA1_CFG3
DATA__2__PA__CFG4 EQU CYREG_UDB_PA1_CFG4
DATA__2__PA__CFG5 EQU CYREG_UDB_PA1_CFG5
DATA__2__PA__CFG6 EQU CYREG_UDB_PA1_CFG6
DATA__2__PA__CFG7 EQU CYREG_UDB_PA1_CFG7
DATA__2__PA__CFG8 EQU CYREG_UDB_PA1_CFG8
DATA__2__PA__CFG9 EQU CYREG_UDB_PA1_CFG9
DATA__2__PC EQU CYREG_PRT1_PC
DATA__2__PC2 EQU CYREG_PRT1_PC2
DATA__2__PORT EQU 1
DATA__2__PS EQU CYREG_PRT1_PS
DATA__2__SHIFT EQU 2
DATA__3__DM__MASK EQU 0xE00
DATA__3__DM__SHIFT EQU 9
DATA__3__DR EQU CYREG_PRT1_DR
DATA__3__HSIOM EQU CYREG_HSIOM_PORT_SEL1
DATA__3__HSIOM_MASK EQU 0x0000F000
DATA__3__HSIOM_SHIFT EQU 12
DATA__3__INTCFG EQU CYREG_PRT1_INTCFG
DATA__3__INTSTAT EQU CYREG_PRT1_INTSTAT
DATA__3__MASK EQU 0x08
DATA__3__PA__CFG0 EQU CYREG_UDB_PA1_CFG0
DATA__3__PA__CFG1 EQU CYREG_UDB_PA1_CFG1
DATA__3__PA__CFG10 EQU CYREG_UDB_PA1_CFG10
DATA__3__PA__CFG11 EQU CYREG_UDB_PA1_CFG11
DATA__3__PA__CFG12 EQU CYREG_UDB_PA1_CFG12
DATA__3__PA__CFG13 EQU CYREG_UDB_PA1_CFG13
DATA__3__PA__CFG14 EQU CYREG_UDB_PA1_CFG14
DATA__3__PA__CFG2 EQU CYREG_UDB_PA1_CFG2
DATA__3__PA__CFG3 EQU CYREG_UDB_PA1_CFG3
DATA__3__PA__CFG4 EQU CYREG_UDB_PA1_CFG4
DATA__3__PA__CFG5 EQU CYREG_UDB_PA1_CFG5
DATA__3__PA__CFG6 EQU CYREG_UDB_PA1_CFG6
DATA__3__PA__CFG7 EQU CYREG_UDB_PA1_CFG7
DATA__3__PA__CFG8 EQU CYREG_UDB_PA1_CFG8
DATA__3__PA__CFG9 EQU CYREG_UDB_PA1_CFG9
DATA__3__PC EQU CYREG_PRT1_PC
DATA__3__PC2 EQU CYREG_PRT1_PC2
DATA__3__PORT EQU 1
DATA__3__PS EQU CYREG_PRT1_PS
DATA__3__SHIFT EQU 3
DATA__4__DM__MASK EQU 0x7000
DATA__4__DM__SHIFT EQU 12
DATA__4__DR EQU CYREG_PRT1_DR
DATA__4__HSIOM EQU CYREG_HSIOM_PORT_SEL1
DATA__4__HSIOM_MASK EQU 0x000F0000
DATA__4__HSIOM_SHIFT EQU 16
DATA__4__INTCFG EQU CYREG_PRT1_INTCFG
DATA__4__INTSTAT EQU CYREG_PRT1_INTSTAT
DATA__4__MASK EQU 0x10
DATA__4__PA__CFG0 EQU CYREG_UDB_PA1_CFG0
DATA__4__PA__CFG1 EQU CYREG_UDB_PA1_CFG1
DATA__4__PA__CFG10 EQU CYREG_UDB_PA1_CFG10
DATA__4__PA__CFG11 EQU CYREG_UDB_PA1_CFG11
DATA__4__PA__CFG12 EQU CYREG_UDB_PA1_CFG12
DATA__4__PA__CFG13 EQU CYREG_UDB_PA1_CFG13
DATA__4__PA__CFG14 EQU CYREG_UDB_PA1_CFG14
DATA__4__PA__CFG2 EQU CYREG_UDB_PA1_CFG2
DATA__4__PA__CFG3 EQU CYREG_UDB_PA1_CFG3
DATA__4__PA__CFG4 EQU CYREG_UDB_PA1_CFG4
DATA__4__PA__CFG5 EQU CYREG_UDB_PA1_CFG5
DATA__4__PA__CFG6 EQU CYREG_UDB_PA1_CFG6
DATA__4__PA__CFG7 EQU CYREG_UDB_PA1_CFG7
DATA__4__PA__CFG8 EQU CYREG_UDB_PA1_CFG8
DATA__4__PA__CFG9 EQU CYREG_UDB_PA1_CFG9
DATA__4__PC EQU CYREG_PRT1_PC
DATA__4__PC2 EQU CYREG_PRT1_PC2
DATA__4__PORT EQU 1
DATA__4__PS EQU CYREG_PRT1_PS
DATA__4__SHIFT EQU 4
DATA__5__DM__MASK EQU 0x38000
DATA__5__DM__SHIFT EQU 15
DATA__5__DR EQU CYREG_PRT1_DR
DATA__5__HSIOM EQU CYREG_HSIOM_PORT_SEL1
DATA__5__HSIOM_MASK EQU 0x00F00000
DATA__5__HSIOM_SHIFT EQU 20
DATA__5__INTCFG EQU CYREG_PRT1_INTCFG
DATA__5__INTSTAT EQU CYREG_PRT1_INTSTAT
DATA__5__MASK EQU 0x20
DATA__5__PA__CFG0 EQU CYREG_UDB_PA1_CFG0
DATA__5__PA__CFG1 EQU CYREG_UDB_PA1_CFG1
DATA__5__PA__CFG10 EQU CYREG_UDB_PA1_CFG10
DATA__5__PA__CFG11 EQU CYREG_UDB_PA1_CFG11
DATA__5__PA__CFG12 EQU CYREG_UDB_PA1_CFG12
DATA__5__PA__CFG13 EQU CYREG_UDB_PA1_CFG13
DATA__5__PA__CFG14 EQU CYREG_UDB_PA1_CFG14
DATA__5__PA__CFG2 EQU CYREG_UDB_PA1_CFG2
DATA__5__PA__CFG3 EQU CYREG_UDB_PA1_CFG3
DATA__5__PA__CFG4 EQU CYREG_UDB_PA1_CFG4
DATA__5__PA__CFG5 EQU CYREG_UDB_PA1_CFG5
DATA__5__PA__CFG6 EQU CYREG_UDB_PA1_CFG6
DATA__5__PA__CFG7 EQU CYREG_UDB_PA1_CFG7
DATA__5__PA__CFG8 EQU CYREG_UDB_PA1_CFG8
DATA__5__PA__CFG9 EQU CYREG_UDB_PA1_CFG9
DATA__5__PC EQU CYREG_PRT1_PC
DATA__5__PC2 EQU CYREG_PRT1_PC2
DATA__5__PORT EQU 1
DATA__5__PS EQU CYREG_PRT1_PS
DATA__5__SHIFT EQU 5
DATA__6__DM__MASK EQU 0x1C0000
DATA__6__DM__SHIFT EQU 18
DATA__6__DR EQU CYREG_PRT1_DR
DATA__6__HSIOM EQU CYREG_HSIOM_PORT_SEL1
DATA__6__HSIOM_MASK EQU 0x0F000000
DATA__6__HSIOM_SHIFT EQU 24
DATA__6__INTCFG EQU CYREG_PRT1_INTCFG
DATA__6__INTSTAT EQU CYREG_PRT1_INTSTAT
DATA__6__MASK EQU 0x40
DATA__6__PA__CFG0 EQU CYREG_UDB_PA1_CFG0
DATA__6__PA__CFG1 EQU CYREG_UDB_PA1_CFG1
DATA__6__PA__CFG10 EQU CYREG_UDB_PA1_CFG10
DATA__6__PA__CFG11 EQU CYREG_UDB_PA1_CFG11
DATA__6__PA__CFG12 EQU CYREG_UDB_PA1_CFG12
DATA__6__PA__CFG13 EQU CYREG_UDB_PA1_CFG13
DATA__6__PA__CFG14 EQU CYREG_UDB_PA1_CFG14
DATA__6__PA__CFG2 EQU CYREG_UDB_PA1_CFG2
DATA__6__PA__CFG3 EQU CYREG_UDB_PA1_CFG3
DATA__6__PA__CFG4 EQU CYREG_UDB_PA1_CFG4
DATA__6__PA__CFG5 EQU CYREG_UDB_PA1_CFG5
DATA__6__PA__CFG6 EQU CYREG_UDB_PA1_CFG6
DATA__6__PA__CFG7 EQU CYREG_UDB_PA1_CFG7
DATA__6__PA__CFG8 EQU CYREG_UDB_PA1_CFG8
DATA__6__PA__CFG9 EQU CYREG_UDB_PA1_CFG9
DATA__6__PC EQU CYREG_PRT1_PC
DATA__6__PC2 EQU CYREG_PRT1_PC2
DATA__6__PORT EQU 1
DATA__6__PS EQU CYREG_PRT1_PS
DATA__6__SHIFT EQU 6
DATA__7__DM__MASK EQU 0xE00000
DATA__7__DM__SHIFT EQU 21
DATA__7__DR EQU CYREG_PRT1_DR
DATA__7__HSIOM EQU CYREG_HSIOM_PORT_SEL1
DATA__7__HSIOM_MASK EQU 0xF0000000
DATA__7__HSIOM_SHIFT EQU 28
DATA__7__INTCFG EQU CYREG_PRT1_INTCFG
DATA__7__INTSTAT EQU CYREG_PRT1_INTSTAT
DATA__7__MASK EQU 0x80
DATA__7__PA__CFG0 EQU CYREG_UDB_PA1_CFG0
DATA__7__PA__CFG1 EQU CYREG_UDB_PA1_CFG1
DATA__7__PA__CFG10 EQU CYREG_UDB_PA1_CFG10
DATA__7__PA__CFG11 EQU CYREG_UDB_PA1_CFG11
DATA__7__PA__CFG12 EQU CYREG_UDB_PA1_CFG12
DATA__7__PA__CFG13 EQU CYREG_UDB_PA1_CFG13
DATA__7__PA__CFG14 EQU CYREG_UDB_PA1_CFG14
DATA__7__PA__CFG2 EQU CYREG_UDB_PA1_CFG2
DATA__7__PA__CFG3 EQU CYREG_UDB_PA1_CFG3
DATA__7__PA__CFG4 EQU CYREG_UDB_PA1_CFG4
DATA__7__PA__CFG5 EQU CYREG_UDB_PA1_CFG5
DATA__7__PA__CFG6 EQU CYREG_UDB_PA1_CFG6
DATA__7__PA__CFG7 EQU CYREG_UDB_PA1_CFG7
DATA__7__PA__CFG8 EQU CYREG_UDB_PA1_CFG8
DATA__7__PA__CFG9 EQU CYREG_UDB_PA1_CFG9
DATA__7__PC EQU CYREG_PRT1_PC
DATA__7__PC2 EQU CYREG_PRT1_PC2
DATA__7__PORT EQU 1
DATA__7__PS EQU CYREG_PRT1_PS
DATA__7__SHIFT EQU 7
DATA__DR EQU CYREG_PRT1_DR
DATA__INTCFG EQU CYREG_PRT1_INTCFG
DATA__INTSTAT EQU CYREG_PRT1_INTSTAT
DATA__MASK EQU 0xFF
DATA__PA__CFG0 EQU CYREG_UDB_PA1_CFG0
DATA__PA__CFG1 EQU CYREG_UDB_PA1_CFG1
DATA__PA__CFG10 EQU CYREG_UDB_PA1_CFG10
DATA__PA__CFG11 EQU CYREG_UDB_PA1_CFG11
DATA__PA__CFG12 EQU CYREG_UDB_PA1_CFG12
DATA__PA__CFG13 EQU CYREG_UDB_PA1_CFG13
DATA__PA__CFG14 EQU CYREG_UDB_PA1_CFG14
DATA__PA__CFG2 EQU CYREG_UDB_PA1_CFG2
DATA__PA__CFG3 EQU CYREG_UDB_PA1_CFG3
DATA__PA__CFG4 EQU CYREG_UDB_PA1_CFG4
DATA__PA__CFG5 EQU CYREG_UDB_PA1_CFG5
DATA__PA__CFG6 EQU CYREG_UDB_PA1_CFG6
DATA__PA__CFG7 EQU CYREG_UDB_PA1_CFG7
DATA__PA__CFG8 EQU CYREG_UDB_PA1_CFG8
DATA__PA__CFG9 EQU CYREG_UDB_PA1_CFG9
DATA__PC EQU CYREG_PRT1_PC
DATA__PC2 EQU CYREG_PRT1_PC2
DATA__PORT EQU 1
DATA__PS EQU CYREG_PRT1_PS
DATA__SHIFT EQU 0

; LCD_CS
LCD_CS__0__DM__MASK EQU 0x1C0
LCD_CS__0__DM__SHIFT EQU 6
LCD_CS__0__DR EQU CYREG_PRT0_DR
LCD_CS__0__HSIOM EQU CYREG_HSIOM_PORT_SEL0
LCD_CS__0__HSIOM_MASK EQU 0x00000F00
LCD_CS__0__HSIOM_SHIFT EQU 8
LCD_CS__0__INTCFG EQU CYREG_PRT0_INTCFG
LCD_CS__0__INTSTAT EQU CYREG_PRT0_INTSTAT
LCD_CS__0__MASK EQU 0x04
LCD_CS__0__PA__CFG0 EQU CYREG_UDB_PA0_CFG0
LCD_CS__0__PA__CFG1 EQU CYREG_UDB_PA0_CFG1
LCD_CS__0__PA__CFG10 EQU CYREG_UDB_PA0_CFG10
LCD_CS__0__PA__CFG11 EQU CYREG_UDB_PA0_CFG11
LCD_CS__0__PA__CFG12 EQU CYREG_UDB_PA0_CFG12
LCD_CS__0__PA__CFG13 EQU CYREG_UDB_PA0_CFG13
LCD_CS__0__PA__CFG14 EQU CYREG_UDB_PA0_CFG14
LCD_CS__0__PA__CFG2 EQU CYREG_UDB_PA0_CFG2
LCD_CS__0__PA__CFG3 EQU CYREG_UDB_PA0_CFG3
LCD_CS__0__PA__CFG4 EQU CYREG_UDB_PA0_CFG4
LCD_CS__0__PA__CFG5 EQU CYREG_UDB_PA0_CFG5
LCD_CS__0__PA__CFG6 EQU CYREG_UDB_PA0_CFG6
LCD_CS__0__PA__CFG7 EQU CYREG_UDB_PA0_CFG7
LCD_CS__0__PA__CFG8 EQU CYREG_UDB_PA0_CFG8
LCD_CS__0__PA__CFG9 EQU CYREG_UDB_PA0_CFG9
LCD_CS__0__PC EQU CYREG_PRT0_PC
LCD_CS__0__PC2 EQU CYREG_PRT0_PC2
LCD_CS__0__PORT EQU 0
LCD_CS__0__PS EQU CYREG_PRT0_PS
LCD_CS__0__SHIFT EQU 2
LCD_CS__DR EQU CYREG_PRT0_DR
LCD_CS__INTCFG EQU CYREG_PRT0_INTCFG
LCD_CS__INTSTAT EQU CYREG_PRT0_INTSTAT
LCD_CS__MASK EQU 0x04
LCD_CS__PA__CFG0 EQU CYREG_UDB_PA0_CFG0
LCD_CS__PA__CFG1 EQU CYREG_UDB_PA0_CFG1
LCD_CS__PA__CFG10 EQU CYREG_UDB_PA0_CFG10
LCD_CS__PA__CFG11 EQU CYREG_UDB_PA0_CFG11
LCD_CS__PA__CFG12 EQU CYREG_UDB_PA0_CFG12
LCD_CS__PA__CFG13 EQU CYREG_UDB_PA0_CFG13
LCD_CS__PA__CFG14 EQU CYREG_UDB_PA0_CFG14
LCD_CS__PA__CFG2 EQU CYREG_UDB_PA0_CFG2
LCD_CS__PA__CFG3 EQU CYREG_UDB_PA0_CFG3
LCD_CS__PA__CFG4 EQU CYREG_UDB_PA0_CFG4
LCD_CS__PA__CFG5 EQU CYREG_UDB_PA0_CFG5
LCD_CS__PA__CFG6 EQU CYREG_UDB_PA0_CFG6
LCD_CS__PA__CFG7 EQU CYREG_UDB_PA0_CFG7
LCD_CS__PA__CFG8 EQU CYREG_UDB_PA0_CFG8
LCD_CS__PA__CFG9 EQU CYREG_UDB_PA0_CFG9
LCD_CS__PC EQU CYREG_PRT0_PC
LCD_CS__PC2 EQU CYREG_PRT0_PC2
LCD_CS__PORT EQU 0
LCD_CS__PS EQU CYREG_PRT0_PS
LCD_CS__SHIFT EQU 2

; LCD_RD
LCD_RD__0__DM__MASK EQU 0x7000
LCD_RD__0__DM__SHIFT EQU 12
LCD_RD__0__DR EQU CYREG_PRT0_DR
LCD_RD__0__HSIOM EQU CYREG_HSIOM_PORT_SEL0
LCD_RD__0__HSIOM_MASK EQU 0x000F0000
LCD_RD__0__HSIOM_SHIFT EQU 16
LCD_RD__0__INTCFG EQU CYREG_PRT0_INTCFG
LCD_RD__0__INTSTAT EQU CYREG_PRT0_INTSTAT
LCD_RD__0__MASK EQU 0x10
LCD_RD__0__PA__CFG0 EQU CYREG_UDB_PA0_CFG0
LCD_RD__0__PA__CFG1 EQU CYREG_UDB_PA0_CFG1
LCD_RD__0__PA__CFG10 EQU CYREG_UDB_PA0_CFG10
LCD_RD__0__PA__CFG11 EQU CYREG_UDB_PA0_CFG11
LCD_RD__0__PA__CFG12 EQU CYREG_UDB_PA0_CFG12
LCD_RD__0__PA__CFG13 EQU CYREG_UDB_PA0_CFG13
LCD_RD__0__PA__CFG14 EQU CYREG_UDB_PA0_CFG14
LCD_RD__0__PA__CFG2 EQU CYREG_UDB_PA0_CFG2
LCD_RD__0__PA__CFG3 EQU CYREG_UDB_PA0_CFG3
LCD_RD__0__PA__CFG4 EQU CYREG_UDB_PA0_CFG4
LCD_RD__0__PA__CFG5 EQU CYREG_UDB_PA0_CFG5
LCD_RD__0__PA__CFG6 EQU CYREG_UDB_PA0_CFG6
LCD_RD__0__PA__CFG7 EQU CYREG_UDB_PA0_CFG7
LCD_RD__0__PA__CFG8 EQU CYREG_UDB_PA0_CFG8
LCD_RD__0__PA__CFG9 EQU CYREG_UDB_PA0_CFG9
LCD_RD__0__PC EQU CYREG_PRT0_PC
LCD_RD__0__PC2 EQU CYREG_PRT0_PC2
LCD_RD__0__PORT EQU 0
LCD_RD__0__PS EQU CYREG_PRT0_PS
LCD_RD__0__SHIFT EQU 4
LCD_RD__DR EQU CYREG_PRT0_DR
LCD_RD__INTCFG EQU CYREG_PRT0_INTCFG
LCD_RD__INTSTAT EQU CYREG_PRT0_INTSTAT
LCD_RD__MASK EQU 0x10
LCD_RD__PA__CFG0 EQU CYREG_UDB_PA0_CFG0
LCD_RD__PA__CFG1 EQU CYREG_UDB_PA0_CFG1
LCD_RD__PA__CFG10 EQU CYREG_UDB_PA0_CFG10
LCD_RD__PA__CFG11 EQU CYREG_UDB_PA0_CFG11
LCD_RD__PA__CFG12 EQU CYREG_UDB_PA0_CFG12
LCD_RD__PA__CFG13 EQU CYREG_UDB_PA0_CFG13
LCD_RD__PA__CFG14 EQU CYREG_UDB_PA0_CFG14
LCD_RD__PA__CFG2 EQU CYREG_UDB_PA0_CFG2
LCD_RD__PA__CFG3 EQU CYREG_UDB_PA0_CFG3
LCD_RD__PA__CFG4 EQU CYREG_UDB_PA0_CFG4
LCD_RD__PA__CFG5 EQU CYREG_UDB_PA0_CFG5
LCD_RD__PA__CFG6 EQU CYREG_UDB_PA0_CFG6
LCD_RD__PA__CFG7 EQU CYREG_UDB_PA0_CFG7
LCD_RD__PA__CFG8 EQU CYREG_UDB_PA0_CFG8
LCD_RD__PA__CFG9 EQU CYREG_UDB_PA0_CFG9
LCD_RD__PC EQU CYREG_PRT0_PC
LCD_RD__PC2 EQU CYREG_PRT0_PC2
LCD_RD__PORT EQU 0
LCD_RD__PS EQU CYREG_PRT0_PS
LCD_RD__SHIFT EQU 4

; LCD_RS
LCD_RS_Sync_ctrl_reg__0__MASK EQU 0x01
LCD_RS_Sync_ctrl_reg__0__POS EQU 0
LCD_RS_Sync_ctrl_reg__16BIT_CONTROL_AUX_CTL_REG EQU CYREG_UDB_W16_ACTL_01
LCD_RS_Sync_ctrl_reg__16BIT_CONTROL_CONTROL_REG EQU CYREG_UDB_W16_CTL_01
LCD_RS_Sync_ctrl_reg__16BIT_CONTROL_COUNT_REG EQU CYREG_UDB_W16_CTL_01
LCD_RS_Sync_ctrl_reg__16BIT_COUNT_CONTROL_REG EQU CYREG_UDB_W16_CTL_01
LCD_RS_Sync_ctrl_reg__16BIT_COUNT_COUNT_REG EQU CYREG_UDB_W16_CTL_01
LCD_RS_Sync_ctrl_reg__16BIT_MASK_MASK_REG EQU CYREG_UDB_W16_MSK_01
LCD_RS_Sync_ctrl_reg__16BIT_MASK_PERIOD_REG EQU CYREG_UDB_W16_MSK_01
LCD_RS_Sync_ctrl_reg__16BIT_PERIOD_MASK_REG EQU CYREG_UDB_W16_MSK_01
LCD_RS_Sync_ctrl_reg__16BIT_PERIOD_PERIOD_REG EQU CYREG_UDB_W16_MSK_01
LCD_RS_Sync_ctrl_reg__CONTROL_AUX_CTL_REG EQU CYREG_UDB_W8_ACTL_01
LCD_RS_Sync_ctrl_reg__CONTROL_REG EQU CYREG_UDB_W8_CTL_01
LCD_RS_Sync_ctrl_reg__CONTROL_ST_REG EQU CYREG_UDB_CAT16_CTL_ST_01
LCD_RS_Sync_ctrl_reg__COUNT_REG EQU CYREG_UDB_W8_CTL_01
LCD_RS_Sync_ctrl_reg__COUNT_ST_REG EQU CYREG_UDB_CAT16_CTL_ST_01
LCD_RS_Sync_ctrl_reg__MASK EQU 0x01
LCD_RS_Sync_ctrl_reg__MASK_CTL_AUX_CTL_REG EQU CYREG_UDB_CAT16_ACTL_MSK_01
LCD_RS_Sync_ctrl_reg__PER_CTL_AUX_CTL_REG EQU CYREG_UDB_CAT16_ACTL_MSK_01
LCD_RS_Sync_ctrl_reg__PERIOD_REG EQU CYREG_UDB_W8_MSK_01

; LCD_WR
LCD_WR__0__DM__MASK EQU 0xE00
LCD_WR__0__DM__SHIFT EQU 9
LCD_WR__0__DR EQU CYREG_PRT0_DR
LCD_WR__0__HSIOM EQU CYREG_HSIOM_PORT_SEL0
LCD_WR__0__HSIOM_MASK EQU 0x0000F000
LCD_WR__0__HSIOM_SHIFT EQU 12
LCD_WR__0__INTCFG EQU CYREG_PRT0_INTCFG
LCD_WR__0__INTSTAT EQU CYREG_PRT0_INTSTAT
LCD_WR__0__MASK EQU 0x08
LCD_WR__0__PA__CFG0 EQU CYREG_UDB_PA0_CFG0
LCD_WR__0__PA__CFG1 EQU CYREG_UDB_PA0_CFG1
LCD_WR__0__PA__CFG10 EQU CYREG_UDB_PA0_CFG10
LCD_WR__0__PA__CFG11 EQU CYREG_UDB_PA0_CFG11
LCD_WR__0__PA__CFG12 EQU CYREG_UDB_PA0_CFG12
LCD_WR__0__PA__CFG13 EQU CYREG_UDB_PA0_CFG13
LCD_WR__0__PA__CFG14 EQU CYREG_UDB_PA0_CFG14
LCD_WR__0__PA__CFG2 EQU CYREG_UDB_PA0_CFG2
LCD_WR__0__PA__CFG3 EQU CYREG_UDB_PA0_CFG3
LCD_WR__0__PA__CFG4 EQU CYREG_UDB_PA0_CFG4
LCD_WR__0__PA__CFG5 EQU CYREG_UDB_PA0_CFG5
LCD_WR__0__PA__CFG6 EQU CYREG_UDB_PA0_CFG6
LCD_WR__0__PA__CFG7 EQU CYREG_UDB_PA0_CFG7
LCD_WR__0__PA__CFG8 EQU CYREG_UDB_PA0_CFG8
LCD_WR__0__PA__CFG9 EQU CYREG_UDB_PA0_CFG9
LCD_WR__0__PC EQU CYREG_PRT0_PC
LCD_WR__0__PC2 EQU CYREG_PRT0_PC2
LCD_WR__0__PORT EQU 0
LCD_WR__0__PS EQU CYREG_PRT0_PS
LCD_WR__0__SHIFT EQU 3
LCD_WR__DR EQU CYREG_PRT0_DR
LCD_WR__INTCFG EQU CYREG_PRT0_INTCFG
LCD_WR__INTSTAT EQU CYREG_PRT0_INTSTAT
LCD_WR__MASK EQU 0x08
LCD_WR__PA__CFG0 EQU CYREG_UDB_PA0_CFG0
LCD_WR__PA__CFG1 EQU CYREG_UDB_PA0_CFG1
LCD_WR__PA__CFG10 EQU CYREG_UDB_PA0_CFG10
LCD_WR__PA__CFG11 EQU CYREG_UDB_PA0_CFG11
LCD_WR__PA__CFG12 EQU CYREG_UDB_PA0_CFG12
LCD_WR__PA__CFG13 EQU CYREG_UDB_PA0_CFG13
LCD_WR__PA__CFG14 EQU CYREG_UDB_PA0_CFG14
LCD_WR__PA__CFG2 EQU CYREG_UDB_PA0_CFG2
LCD_WR__PA__CFG3 EQU CYREG_UDB_PA0_CFG3
LCD_WR__PA__CFG4 EQU CYREG_UDB_PA0_CFG4
LCD_WR__PA__CFG5 EQU CYREG_UDB_PA0_CFG5
LCD_WR__PA__CFG6 EQU CYREG_UDB_PA0_CFG6
LCD_WR__PA__CFG7 EQU CYREG_UDB_PA0_CFG7
LCD_WR__PA__CFG8 EQU CYREG_UDB_PA0_CFG8
LCD_WR__PA__CFG9 EQU CYREG_UDB_PA0_CFG9
LCD_WR__PC EQU CYREG_PRT0_PC
LCD_WR__PC2 EQU CYREG_PRT0_PC2
LCD_WR__PORT EQU 0
LCD_WR__PS EQU CYREG_PRT0_PS
LCD_WR__SHIFT EQU 3

; LCD_RST
LCD_RST__0__DM__MASK EQU 0x38
LCD_RST__0__DM__SHIFT EQU 3
LCD_RST__0__DR EQU CYREG_PRT0_DR
LCD_RST__0__HSIOM EQU CYREG_HSIOM_PORT_SEL0
LCD_RST__0__HSIOM_MASK EQU 0x000000F0
LCD_RST__0__HSIOM_SHIFT EQU 4
LCD_RST__0__INTCFG EQU CYREG_PRT0_INTCFG
LCD_RST__0__INTSTAT EQU CYREG_PRT0_INTSTAT
LCD_RST__0__MASK EQU 0x02
LCD_RST__0__PA__CFG0 EQU CYREG_UDB_PA0_CFG0
LCD_RST__0__PA__CFG1 EQU CYREG_UDB_PA0_CFG1
LCD_RST__0__PA__CFG10 EQU CYREG_UDB_PA0_CFG10
LCD_RST__0__PA__CFG11 EQU CYREG_UDB_PA0_CFG11
LCD_RST__0__PA__CFG12 EQU CYREG_UDB_PA0_CFG12
LCD_RST__0__PA__CFG13 EQU CYREG_UDB_PA0_CFG13
LCD_RST__0__PA__CFG14 EQU CYREG_UDB_PA0_CFG14
LCD_RST__0__PA__CFG2 EQU CYREG_UDB_PA0_CFG2
LCD_RST__0__PA__CFG3 EQU CYREG_UDB_PA0_CFG3
LCD_RST__0__PA__CFG4 EQU CYREG_UDB_PA0_CFG4
LCD_RST__0__PA__CFG5 EQU CYREG_UDB_PA0_CFG5
LCD_RST__0__PA__CFG6 EQU CYREG_UDB_PA0_CFG6
LCD_RST__0__PA__CFG7 EQU CYREG_UDB_PA0_CFG7
LCD_RST__0__PA__CFG8 EQU CYREG_UDB_PA0_CFG8
LCD_RST__0__PA__CFG9 EQU CYREG_UDB_PA0_CFG9
LCD_RST__0__PC EQU CYREG_PRT0_PC
LCD_RST__0__PC2 EQU CYREG_PRT0_PC2
LCD_RST__0__PORT EQU 0
LCD_RST__0__PS EQU CYREG_PRT0_PS
LCD_RST__0__SHIFT EQU 1
LCD_RST__DR EQU CYREG_PRT0_DR
LCD_RST__INTCFG EQU CYREG_PRT0_INTCFG
LCD_RST__INTSTAT EQU CYREG_PRT0_INTSTAT
LCD_RST__MASK EQU 0x02
LCD_RST__PA__CFG0 EQU CYREG_UDB_PA0_CFG0
LCD_RST__PA__CFG1 EQU CYREG_UDB_PA0_CFG1
LCD_RST__PA__CFG10 EQU CYREG_UDB_PA0_CFG10
LCD_RST__PA__CFG11 EQU CYREG_UDB_PA0_CFG11
LCD_RST__PA__CFG12 EQU CYREG_UDB_PA0_CFG12
LCD_RST__PA__CFG13 EQU CYREG_UDB_PA0_CFG13
LCD_RST__PA__CFG14 EQU CYREG_UDB_PA0_CFG14
LCD_RST__PA__CFG2 EQU CYREG_UDB_PA0_CFG2
LCD_RST__PA__CFG3 EQU CYREG_UDB_PA0_CFG3
LCD_RST__PA__CFG4 EQU CYREG_UDB_PA0_CFG4
LCD_RST__PA__CFG5 EQU CYREG_UDB_PA0_CFG5
LCD_RST__PA__CFG6 EQU CYREG_UDB_PA0_CFG6
LCD_RST__PA__CFG7 EQU CYREG_UDB_PA0_CFG7
LCD_RST__PA__CFG8 EQU CYREG_UDB_PA0_CFG8
LCD_RST__PA__CFG9 EQU CYREG_UDB_PA0_CFG9
LCD_RST__PC EQU CYREG_PRT0_PC
LCD_RST__PC2 EQU CYREG_PRT0_PC2
LCD_RST__PORT EQU 0
LCD_RST__PS EQU CYREG_PRT0_PS
LCD_RST__SHIFT EQU 1

; DDR_DATA
DDR_DATA_Sync_ctrl_reg__0__MASK EQU 0x01
DDR_DATA_Sync_ctrl_reg__0__POS EQU 0
DDR_DATA_Sync_ctrl_reg__CONTROL_AUX_CTL_REG EQU CYREG_UDB_W8_ACTL_03
DDR_DATA_Sync_ctrl_reg__CONTROL_REG EQU CYREG_UDB_W8_CTL_03
DDR_DATA_Sync_ctrl_reg__CONTROL_ST_REG EQU CYREG_UDB_CAT16_CTL_ST_03
DDR_DATA_Sync_ctrl_reg__COUNT_REG EQU CYREG_UDB_W8_CTL_03
DDR_DATA_Sync_ctrl_reg__COUNT_ST_REG EQU CYREG_UDB_CAT16_CTL_ST_03
DDR_DATA_Sync_ctrl_reg__MASK EQU 0x01
DDR_DATA_Sync_ctrl_reg__MASK_CTL_AUX_CTL_REG EQU CYREG_UDB_CAT16_ACTL_MSK_03
DDR_DATA_Sync_ctrl_reg__PER_CTL_AUX_CTL_REG EQU CYREG_UDB_CAT16_ACTL_MSK_03
DDR_DATA_Sync_ctrl_reg__PERIOD_REG EQU CYREG_UDB_W8_MSK_03

; Read_enable
Read_enable_Sync_ctrl_reg__0__MASK EQU 0x01
Read_enable_Sync_ctrl_reg__0__POS EQU 0
Read_enable_Sync_ctrl_reg__16BIT_CONTROL_AUX_CTL_REG EQU CYREG_UDB_W16_ACTL_02
Read_enable_Sync_ctrl_reg__16BIT_CONTROL_CONTROL_REG EQU CYREG_UDB_W16_CTL_02
Read_enable_Sync_ctrl_reg__16BIT_CONTROL_COUNT_REG EQU CYREG_UDB_W16_CTL_02
Read_enable_Sync_ctrl_reg__16BIT_COUNT_CONTROL_REG EQU CYREG_UDB_W16_CTL_02
Read_enable_Sync_ctrl_reg__16BIT_COUNT_COUNT_REG EQU CYREG_UDB_W16_CTL_02
Read_enable_Sync_ctrl_reg__16BIT_MASK_MASK_REG EQU CYREG_UDB_W16_MSK_02
Read_enable_Sync_ctrl_reg__16BIT_MASK_PERIOD_REG EQU CYREG_UDB_W16_MSK_02
Read_enable_Sync_ctrl_reg__16BIT_PERIOD_MASK_REG EQU CYREG_UDB_W16_MSK_02
Read_enable_Sync_ctrl_reg__16BIT_PERIOD_PERIOD_REG EQU CYREG_UDB_W16_MSK_02
Read_enable_Sync_ctrl_reg__CONTROL_AUX_CTL_REG EQU CYREG_UDB_W8_ACTL_02
Read_enable_Sync_ctrl_reg__CONTROL_REG EQU CYREG_UDB_W8_CTL_02
Read_enable_Sync_ctrl_reg__CONTROL_ST_REG EQU CYREG_UDB_CAT16_CTL_ST_02
Read_enable_Sync_ctrl_reg__COUNT_REG EQU CYREG_UDB_W8_CTL_02
Read_enable_Sync_ctrl_reg__COUNT_ST_REG EQU CYREG_UDB_CAT16_CTL_ST_02
Read_enable_Sync_ctrl_reg__MASK EQU 0x01
Read_enable_Sync_ctrl_reg__MASK_CTL_AUX_CTL_REG EQU CYREG_UDB_CAT16_ACTL_MSK_02
Read_enable_Sync_ctrl_reg__PER_CTL_AUX_CTL_REG EQU CYREG_UDB_CAT16_ACTL_MSK_02
Read_enable_Sync_ctrl_reg__PERIOD_REG EQU CYREG_UDB_W8_MSK_02

; LCD_protected_RS
LCD_protected_RS__0__DM__MASK EQU 0x07
LCD_protected_RS__0__DM__SHIFT EQU 0
LCD_protected_RS__0__DR EQU CYREG_PRT0_DR
LCD_protected_RS__0__HSIOM EQU CYREG_HSIOM_PORT_SEL0
LCD_protected_RS__0__HSIOM_MASK EQU 0x0000000F
LCD_protected_RS__0__HSIOM_SHIFT EQU 0
LCD_protected_RS__0__INTCFG EQU CYREG_PRT0_INTCFG
LCD_protected_RS__0__INTSTAT EQU CYREG_PRT0_INTSTAT
LCD_protected_RS__0__MASK EQU 0x01
LCD_protected_RS__0__OUT_SEL EQU CYREG_UDB_PA0_CFG10
LCD_protected_RS__0__OUT_SEL_SHIFT EQU 0
LCD_protected_RS__0__OUT_SEL_VAL EQU 1
LCD_protected_RS__0__PA__CFG0 EQU CYREG_UDB_PA0_CFG0
LCD_protected_RS__0__PA__CFG1 EQU CYREG_UDB_PA0_CFG1
LCD_protected_RS__0__PA__CFG10 EQU CYREG_UDB_PA0_CFG10
LCD_protected_RS__0__PA__CFG11 EQU CYREG_UDB_PA0_CFG11
LCD_protected_RS__0__PA__CFG12 EQU CYREG_UDB_PA0_CFG12
LCD_protected_RS__0__PA__CFG13 EQU CYREG_UDB_PA0_CFG13
LCD_protected_RS__0__PA__CFG14 EQU CYREG_UDB_PA0_CFG14
LCD_protected_RS__0__PA__CFG2 EQU CYREG_UDB_PA0_CFG2
LCD_protected_RS__0__PA__CFG3 EQU CYREG_UDB_PA0_CFG3
LCD_protected_RS__0__PA__CFG4 EQU CYREG_UDB_PA0_CFG4
LCD_protected_RS__0__PA__CFG5 EQU CYREG_UDB_PA0_CFG5
LCD_protected_RS__0__PA__CFG6 EQU CYREG_UDB_PA0_CFG6
LCD_protected_RS__0__PA__CFG7 EQU CYREG_UDB_PA0_CFG7
LCD_protected_RS__0__PA__CFG8 EQU CYREG_UDB_PA0_CFG8
LCD_protected_RS__0__PA__CFG9 EQU CYREG_UDB_PA0_CFG9
LCD_protected_RS__0__PC EQU CYREG_PRT0_PC
LCD_protected_RS__0__PC2 EQU CYREG_PRT0_PC2
LCD_protected_RS__0__PORT EQU 0
LCD_protected_RS__0__PS EQU CYREG_PRT0_PS
LCD_protected_RS__0__SHIFT EQU 0
LCD_protected_RS__DR EQU CYREG_PRT0_DR
LCD_protected_RS__INTCFG EQU CYREG_PRT0_INTCFG
LCD_protected_RS__INTSTAT EQU CYREG_PRT0_INTSTAT
LCD_protected_RS__MASK EQU 0x01
LCD_protected_RS__PA__CFG0 EQU CYREG_UDB_PA0_CFG0
LCD_protected_RS__PA__CFG1 EQU CYREG_UDB_PA0_CFG1
LCD_protected_RS__PA__CFG10 EQU CYREG_UDB_PA0_CFG10
LCD_protected_RS__PA__CFG11 EQU CYREG_UDB_PA0_CFG11
LCD_protected_RS__PA__CFG12 EQU CYREG_UDB_PA0_CFG12
LCD_protected_RS__PA__CFG13 EQU CYREG_UDB_PA0_CFG13
LCD_protected_RS__PA__CFG14 EQU CYREG_UDB_PA0_CFG14
LCD_protected_RS__PA__CFG2 EQU CYREG_UDB_PA0_CFG2
LCD_protected_RS__PA__CFG3 EQU CYREG_UDB_PA0_CFG3
LCD_protected_RS__PA__CFG4 EQU CYREG_UDB_PA0_CFG4
LCD_protected_RS__PA__CFG5 EQU CYREG_UDB_PA0_CFG5
LCD_protected_RS__PA__CFG6 EQU CYREG_UDB_PA0_CFG6
LCD_protected_RS__PA__CFG7 EQU CYREG_UDB_PA0_CFG7
LCD_protected_RS__PA__CFG8 EQU CYREG_UDB_PA0_CFG8
LCD_protected_RS__PA__CFG9 EQU CYREG_UDB_PA0_CFG9
LCD_protected_RS__PC EQU CYREG_PRT0_PC
LCD_protected_RS__PC2 EQU CYREG_PRT0_PC2
LCD_protected_RS__PORT EQU 0
LCD_protected_RS__PS EQU CYREG_PRT0_PS
LCD_protected_RS__SHIFT EQU 0

; Miscellaneous
CYDEV_BCLK__HFCLK__HZ EQU 24000000
CYDEV_BCLK__HFCLK__KHZ EQU 24000
CYDEV_BCLK__HFCLK__MHZ EQU 24
CYDEV_BCLK__SYSCLK__HZ EQU 24000000
CYDEV_BCLK__SYSCLK__KHZ EQU 24000
CYDEV_BCLK__SYSCLK__MHZ EQU 24
CYDEV_CHIP_DIE_LEOPARD EQU 1
CYDEV_CHIP_DIE_PSOC4A EQU 12
CYDEV_CHIP_DIE_PSOC5LP EQU 19
CYDEV_CHIP_DIE_PSOC5TM EQU 20
CYDEV_CHIP_DIE_TMA4 EQU 2
CYDEV_CHIP_DIE_UNKNOWN EQU 0
CYDEV_CHIP_FAMILY_FM0P EQU 4
CYDEV_CHIP_FAMILY_FM3 EQU 5
CYDEV_CHIP_FAMILY_FM4 EQU 6
CYDEV_CHIP_FAMILY_PSOC3 EQU 1
CYDEV_CHIP_FAMILY_PSOC4 EQU 2
CYDEV_CHIP_FAMILY_PSOC5 EQU 3
CYDEV_CHIP_FAMILY_UNKNOWN EQU 0
CYDEV_CHIP_FAMILY_USED EQU CYDEV_CHIP_FAMILY_PSOC4
CYDEV_CHIP_JTAG_ID EQU 0x04C81193
CYDEV_CHIP_MEMBER_3A EQU 1
CYDEV_CHIP_MEMBER_4A EQU 12
CYDEV_CHIP_MEMBER_4C EQU 18
CYDEV_CHIP_MEMBER_4D EQU 8
CYDEV_CHIP_MEMBER_4E EQU 4
CYDEV_CHIP_MEMBER_4F EQU 13
CYDEV_CHIP_MEMBER_4G EQU 2
CYDEV_CHIP_MEMBER_4H EQU 11
CYDEV_CHIP_MEMBER_4I EQU 17
CYDEV_CHIP_MEMBER_4J EQU 9
CYDEV_CHIP_MEMBER_4K EQU 10
CYDEV_CHIP_MEMBER_4L EQU 16
CYDEV_CHIP_MEMBER_4M EQU 15
CYDEV_CHIP_MEMBER_4N EQU 6
CYDEV_CHIP_MEMBER_4O EQU 5
CYDEV_CHIP_MEMBER_4P EQU 14
CYDEV_CHIP_MEMBER_4Q EQU 7
CYDEV_CHIP_MEMBER_4U EQU 3
CYDEV_CHIP_MEMBER_5A EQU 20
CYDEV_CHIP_MEMBER_5B EQU 19
CYDEV_CHIP_MEMBER_FM3 EQU 24
CYDEV_CHIP_MEMBER_FM4 EQU 25
CYDEV_CHIP_MEMBER_PDL_FM0P_TYPE1 EQU 21
CYDEV_CHIP_MEMBER_PDL_FM0P_TYPE2 EQU 22
CYDEV_CHIP_MEMBER_PDL_FM0P_TYPE3 EQU 23
CYDEV_CHIP_MEMBER_UNKNOWN EQU 0
CYDEV_CHIP_MEMBER_USED EQU CYDEV_CHIP_MEMBER_4A
CYDEV_CHIP_DIE_EXPECT EQU CYDEV_CHIP_MEMBER_USED
CYDEV_CHIP_DIE_ACTUAL EQU CYDEV_CHIP_DIE_EXPECT
CYDEV_CHIP_REV_LEOPARD_ES1 EQU 0
CYDEV_CHIP_REV_LEOPARD_ES2 EQU 1
CYDEV_CHIP_REV_LEOPARD_ES3 EQU 3
CYDEV_CHIP_REV_LEOPARD_PRODUCTION EQU 3
CYDEV_CHIP_REV_PSOC4A_ES0 EQU 17
CYDEV_CHIP_REV_PSOC4A_PRODUCTION EQU 17
CYDEV_CHIP_REV_PSOC5LP_ES0 EQU 0
CYDEV_CHIP_REV_PSOC5LP_PRODUCTION EQU 0
CYDEV_CHIP_REV_PSOC5TM_ES0 EQU 0
CYDEV_CHIP_REV_PSOC5TM_ES1 EQU 1
CYDEV_CHIP_REV_PSOC5TM_PRODUCTION EQU 1
CYDEV_CHIP_REV_TMA4_ES EQU 17
CYDEV_CHIP_REV_TMA4_ES2 EQU 33
CYDEV_CHIP_REV_TMA4_PRODUCTION EQU 17
CYDEV_CHIP_REVISION_3A_ES1 EQU 0
CYDEV_CHIP_REVISION_3A_ES2 EQU 1
CYDEV_CHIP_REVISION_3A_ES3 EQU 3
CYDEV_CHIP_REVISION_3A_PRODUCTION EQU 3
CYDEV_CHIP_REVISION_4A_ES0 EQU 17
CYDEV_CHIP_REVISION_4A_PRODUCTION EQU 17
CYDEV_CHIP_REVISION_4C_PRODUCTION EQU 0
CYDEV_CHIP_REVISION_4D_PRODUCTION EQU 0
CYDEV_CHIP_REVISION_4E_PRODUCTION EQU 0
CYDEV_CHIP_REVISION_4F_PRODUCTION EQU 0
CYDEV_CHIP_REVISION_4F_PRODUCTION_256DMA EQU 0
CYDEV_CHIP_REVISION_4F_PRODUCTION_256K EQU 0
CYDEV_CHIP_REVISION_4G_ES EQU 17
CYDEV_CHIP_REVISION_4G_ES2 EQU 33
CYDEV_CHIP_REVISION_4G_PRODUCTION EQU 17
CYDEV_CHIP_REVISION_4H_PRODUCTION EQU 0
CYDEV_CHIP_REVISION_4I_PRODUCTION EQU 0
CYDEV_CHIP_REVISION_4J_PRODUCTION EQU 0
CYDEV_CHIP_REVISION_4K_PRODUCTION EQU 0
CYDEV_CHIP_REVISION_4L_PRODUCTION EQU 0
CYDEV_CHIP_REVISION_4M_PRODUCTION EQU 0
CYDEV_CHIP_REVISION_4N_PRODUCTION EQU 0
CYDEV_CHIP_REVISION_4O_PRODUCTION EQU 0
CYDEV_CHIP_REVISION_4P_PRODUCTION EQU 0
CYDEV_CHIP_REVISION_4Q_PRODUCTION EQU 0
CYDEV_CHIP_REVISION_4U_PRODUCTION EQU 0
CYDEV_CHIP_REVISION_5A_ES0 EQU 0
CYDEV_CHIP_REVISION_5A_ES1 EQU 1
CYDEV_CHIP_REVISION_5A_PRODUCTION EQU 1
CYDEV_CHIP_REVISION_5B_ES0 EQU 0
CYDEV_CHIP_REVISION_5B_PRODUCTION EQU 0
CYDEV_CHIP_REVISION_FM3_PRODUCTION EQU 0
CYDEV_CHIP_REVISION_FM4_PRODUCTION EQU 0
CYDEV_CHIP_REVISION_PDL_FM0P_TYPE1_PRODUCTION EQU 0
CYDEV_CHIP_REVISION_PDL_FM0P_TYPE2_PRODUCTION EQU 0
CYDEV_CHIP_REVISION_PDL_FM0P_TYPE3_PRODUCTION EQU 0
CYDEV_CHIP_REVISION_USED EQU CYDEV_CHIP_REVISION_4A_PRODUCTION
CYDEV_CHIP_REV_EXPECT EQU CYDEV_CHIP_REVISION_USED
CYDEV_CONFIG_READ_ACCELERATOR EQU 1
CYDEV_CONFIG_UNUSED_IO_AllowButWarn EQU 0
CYDEV_CONFIG_UNUSED_IO_AllowWithInfo EQU 1
CYDEV_CONFIG_UNUSED_IO_Disallowed EQU 2
CYDEV_CONFIG_UNUSED_IO EQU CYDEV_CONFIG_UNUSED_IO_Disallowed
CYDEV_CONFIGURATION_COMPRESSED EQU 1
CYDEV_CONFIGURATION_MODE_COMPRESSED EQU 0
CYDEV_CONFIGURATION_MODE EQU CYDEV_CONFIGURATION_MODE_COMPRESSED
CYDEV_CONFIGURATION_MODE_DMA EQU 2
CYDEV_CONFIGURATION_MODE_UNCOMPRESSED EQU 1
CYDEV_DEBUG_PROTECT_KILL EQU 4
CYDEV_DEBUG_PROTECT_OPEN EQU 1
CYDEV_DEBUG_PROTECT EQU CYDEV_DEBUG_PROTECT_OPEN
CYDEV_DEBUG_PROTECT_PROTECTED EQU 2
CYDEV_DEBUGGING_DPS_Disable EQU 3
CYDEV_DEBUGGING_DPS_SWD EQU 2
CYDEV_DEBUGGING_DPS EQU CYDEV_DEBUGGING_DPS_SWD
CYDEV_DEBUGGING_ENABLE EQU 1
CYDEV_DFT_SELECT_CLK0 EQU 1
CYDEV_DFT_SELECT_CLK1 EQU 2
CYDEV_HEAP_SIZE EQU 0x80
CYDEV_IMO_TRIMMED_BY_USB EQU 0
CYDEV_IMO_TRIMMED_BY_WCO EQU 0
CYDEV_IS_EXPORTING_CODE EQU 0
CYDEV_IS_IMPORTING_CODE EQU 0
CYDEV_PROJ_TYPE EQU 0
CYDEV_PROJ_TYPE_BOOTLOADER EQU 1
CYDEV_PROJ_TYPE_LAUNCHER EQU 5
CYDEV_PROJ_TYPE_LOADABLE EQU 2
CYDEV_PROJ_TYPE_LOADABLEANDBOOTLOADER EQU 4
CYDEV_PROJ_TYPE_MULTIAPPBOOTLOADER EQU 3
CYDEV_PROJ_TYPE_STANDARD EQU 0
CYDEV_STACK_SIZE EQU 0x0400
CYDEV_USE_BUNDLED_CMSIS EQU 1
CYDEV_VARIABLE_VDDA EQU 1
CYDEV_VDDA_MV EQU 3300
CYDEV_VDDD_MV EQU 3300
CYDEV_WDT_GENERATE_ISR EQU 1
CYIPBLOCK_M0S8_CTBM_VERSION EQU 0
CYIPBLOCK_m0s8cpuss_VERSION EQU 0
CYIPBLOCK_m0s8csd_VERSION EQU 0
CYIPBLOCK_m0s8gpio2_VERSION EQU 0
CYIPBLOCK_m0s8hsiom4a_VERSION EQU 0
CYIPBLOCK_m0s8lcd_VERSION EQU 0
CYIPBLOCK_m0s8lpcomp_VERSION EQU 0
CYIPBLOCK_m0s8pclk_VERSION EQU 0
CYIPBLOCK_m0s8sar_VERSION EQU 0
CYIPBLOCK_m0s8scb_VERSION EQU 0
CYIPBLOCK_m0s8srssv2_VERSION EQU 1
CYIPBLOCK_m0s8tcpwm_VERSION EQU 0
CYIPBLOCK_m0s8udbif_VERSION EQU 0
CYIPBLOCK_S8_GPIO_VERSION EQU 2
CYDEV_BOOTLOADER_ENABLE EQU 0
    ENDIF
    END
