.ifndef INCLUDED_CYFITTERGNU_INC
.set INCLUDED_CYFITTERGNU_INC, 1
.include "cydevicegnu_trm.inc"

/* DATA */
.set DATA__0__DM__MASK, 0x07
.set DATA__0__DM__SHIFT, 0
.set DATA__0__DR, CYREG_PRT1_DR
.set DATA__0__HSIOM, CYREG_HSIOM_PORT_SEL1
.set DATA__0__HSIOM_MASK, 0x0000000F
.set DATA__0__HSIOM_SHIFT, 0
.set DATA__0__INTCFG, CYREG_PRT1_INTCFG
.set DATA__0__INTSTAT, CYREG_PRT1_INTSTAT
.set DATA__0__MASK, 0x01
.set DATA__0__PA__CFG0, CYREG_UDB_PA1_CFG0
.set DATA__0__PA__CFG1, CYREG_UDB_PA1_CFG1
.set DATA__0__PA__CFG10, CYREG_UDB_PA1_CFG10
.set DATA__0__PA__CFG11, CYREG_UDB_PA1_CFG11
.set DATA__0__PA__CFG12, CYREG_UDB_PA1_CFG12
.set DATA__0__PA__CFG13, CYREG_UDB_PA1_CFG13
.set DATA__0__PA__CFG14, CYREG_UDB_PA1_CFG14
.set DATA__0__PA__CFG2, CYREG_UDB_PA1_CFG2
.set DATA__0__PA__CFG3, CYREG_UDB_PA1_CFG3
.set DATA__0__PA__CFG4, CYREG_UDB_PA1_CFG4
.set DATA__0__PA__CFG5, CYREG_UDB_PA1_CFG5
.set DATA__0__PA__CFG6, CYREG_UDB_PA1_CFG6
.set DATA__0__PA__CFG7, CYREG_UDB_PA1_CFG7
.set DATA__0__PA__CFG8, CYREG_UDB_PA1_CFG8
.set DATA__0__PA__CFG9, CYREG_UDB_PA1_CFG9
.set DATA__0__PC, CYREG_PRT1_PC
.set DATA__0__PC2, CYREG_PRT1_PC2
.set DATA__0__PORT, 1
.set DATA__0__PS, CYREG_PRT1_PS
.set DATA__0__SHIFT, 0
.set DATA__1__DM__MASK, 0x38
.set DATA__1__DM__SHIFT, 3
.set DATA__1__DR, CYREG_PRT1_DR
.set DATA__1__HSIOM, CYREG_HSIOM_PORT_SEL1
.set DATA__1__HSIOM_MASK, 0x000000F0
.set DATA__1__HSIOM_SHIFT, 4
.set DATA__1__INTCFG, CYREG_PRT1_INTCFG
.set DATA__1__INTSTAT, CYREG_PRT1_INTSTAT
.set DATA__1__MASK, 0x02
.set DATA__1__PA__CFG0, CYREG_UDB_PA1_CFG0
.set DATA__1__PA__CFG1, CYREG_UDB_PA1_CFG1
.set DATA__1__PA__CFG10, CYREG_UDB_PA1_CFG10
.set DATA__1__PA__CFG11, CYREG_UDB_PA1_CFG11
.set DATA__1__PA__CFG12, CYREG_UDB_PA1_CFG12
.set DATA__1__PA__CFG13, CYREG_UDB_PA1_CFG13
.set DATA__1__PA__CFG14, CYREG_UDB_PA1_CFG14
.set DATA__1__PA__CFG2, CYREG_UDB_PA1_CFG2
.set DATA__1__PA__CFG3, CYREG_UDB_PA1_CFG3
.set DATA__1__PA__CFG4, CYREG_UDB_PA1_CFG4
.set DATA__1__PA__CFG5, CYREG_UDB_PA1_CFG5
.set DATA__1__PA__CFG6, CYREG_UDB_PA1_CFG6
.set DATA__1__PA__CFG7, CYREG_UDB_PA1_CFG7
.set DATA__1__PA__CFG8, CYREG_UDB_PA1_CFG8
.set DATA__1__PA__CFG9, CYREG_UDB_PA1_CFG9
.set DATA__1__PC, CYREG_PRT1_PC
.set DATA__1__PC2, CYREG_PRT1_PC2
.set DATA__1__PORT, 1
.set DATA__1__PS, CYREG_PRT1_PS
.set DATA__1__SHIFT, 1
.set DATA__2__DM__MASK, 0x1C0
.set DATA__2__DM__SHIFT, 6
.set DATA__2__DR, CYREG_PRT1_DR
.set DATA__2__HSIOM, CYREG_HSIOM_PORT_SEL1
.set DATA__2__HSIOM_MASK, 0x00000F00
.set DATA__2__HSIOM_SHIFT, 8
.set DATA__2__INTCFG, CYREG_PRT1_INTCFG
.set DATA__2__INTSTAT, CYREG_PRT1_INTSTAT
.set DATA__2__MASK, 0x04
.set DATA__2__PA__CFG0, CYREG_UDB_PA1_CFG0
.set DATA__2__PA__CFG1, CYREG_UDB_PA1_CFG1
.set DATA__2__PA__CFG10, CYREG_UDB_PA1_CFG10
.set DATA__2__PA__CFG11, CYREG_UDB_PA1_CFG11
.set DATA__2__PA__CFG12, CYREG_UDB_PA1_CFG12
.set DATA__2__PA__CFG13, CYREG_UDB_PA1_CFG13
.set DATA__2__PA__CFG14, CYREG_UDB_PA1_CFG14
.set DATA__2__PA__CFG2, CYREG_UDB_PA1_CFG2
.set DATA__2__PA__CFG3, CYREG_UDB_PA1_CFG3
.set DATA__2__PA__CFG4, CYREG_UDB_PA1_CFG4
.set DATA__2__PA__CFG5, CYREG_UDB_PA1_CFG5
.set DATA__2__PA__CFG6, CYREG_UDB_PA1_CFG6
.set DATA__2__PA__CFG7, CYREG_UDB_PA1_CFG7
.set DATA__2__PA__CFG8, CYREG_UDB_PA1_CFG8
.set DATA__2__PA__CFG9, CYREG_UDB_PA1_CFG9
.set DATA__2__PC, CYREG_PRT1_PC
.set DATA__2__PC2, CYREG_PRT1_PC2
.set DATA__2__PORT, 1
.set DATA__2__PS, CYREG_PRT1_PS
.set DATA__2__SHIFT, 2
.set DATA__3__DM__MASK, 0xE00
.set DATA__3__DM__SHIFT, 9
.set DATA__3__DR, CYREG_PRT1_DR
.set DATA__3__HSIOM, CYREG_HSIOM_PORT_SEL1
.set DATA__3__HSIOM_MASK, 0x0000F000
.set DATA__3__HSIOM_SHIFT, 12
.set DATA__3__INTCFG, CYREG_PRT1_INTCFG
.set DATA__3__INTSTAT, CYREG_PRT1_INTSTAT
.set DATA__3__MASK, 0x08
.set DATA__3__PA__CFG0, CYREG_UDB_PA1_CFG0
.set DATA__3__PA__CFG1, CYREG_UDB_PA1_CFG1
.set DATA__3__PA__CFG10, CYREG_UDB_PA1_CFG10
.set DATA__3__PA__CFG11, CYREG_UDB_PA1_CFG11
.set DATA__3__PA__CFG12, CYREG_UDB_PA1_CFG12
.set DATA__3__PA__CFG13, CYREG_UDB_PA1_CFG13
.set DATA__3__PA__CFG14, CYREG_UDB_PA1_CFG14
.set DATA__3__PA__CFG2, CYREG_UDB_PA1_CFG2
.set DATA__3__PA__CFG3, CYREG_UDB_PA1_CFG3
.set DATA__3__PA__CFG4, CYREG_UDB_PA1_CFG4
.set DATA__3__PA__CFG5, CYREG_UDB_PA1_CFG5
.set DATA__3__PA__CFG6, CYREG_UDB_PA1_CFG6
.set DATA__3__PA__CFG7, CYREG_UDB_PA1_CFG7
.set DATA__3__PA__CFG8, CYREG_UDB_PA1_CFG8
.set DATA__3__PA__CFG9, CYREG_UDB_PA1_CFG9
.set DATA__3__PC, CYREG_PRT1_PC
.set DATA__3__PC2, CYREG_PRT1_PC2
.set DATA__3__PORT, 1
.set DATA__3__PS, CYREG_PRT1_PS
.set DATA__3__SHIFT, 3
.set DATA__4__DM__MASK, 0x7000
.set DATA__4__DM__SHIFT, 12
.set DATA__4__DR, CYREG_PRT1_DR
.set DATA__4__HSIOM, CYREG_HSIOM_PORT_SEL1
.set DATA__4__HSIOM_MASK, 0x000F0000
.set DATA__4__HSIOM_SHIFT, 16
.set DATA__4__INTCFG, CYREG_PRT1_INTCFG
.set DATA__4__INTSTAT, CYREG_PRT1_INTSTAT
.set DATA__4__MASK, 0x10
.set DATA__4__PA__CFG0, CYREG_UDB_PA1_CFG0
.set DATA__4__PA__CFG1, CYREG_UDB_PA1_CFG1
.set DATA__4__PA__CFG10, CYREG_UDB_PA1_CFG10
.set DATA__4__PA__CFG11, CYREG_UDB_PA1_CFG11
.set DATA__4__PA__CFG12, CYREG_UDB_PA1_CFG12
.set DATA__4__PA__CFG13, CYREG_UDB_PA1_CFG13
.set DATA__4__PA__CFG14, CYREG_UDB_PA1_CFG14
.set DATA__4__PA__CFG2, CYREG_UDB_PA1_CFG2
.set DATA__4__PA__CFG3, CYREG_UDB_PA1_CFG3
.set DATA__4__PA__CFG4, CYREG_UDB_PA1_CFG4
.set DATA__4__PA__CFG5, CYREG_UDB_PA1_CFG5
.set DATA__4__PA__CFG6, CYREG_UDB_PA1_CFG6
.set DATA__4__PA__CFG7, CYREG_UDB_PA1_CFG7
.set DATA__4__PA__CFG8, CYREG_UDB_PA1_CFG8
.set DATA__4__PA__CFG9, CYREG_UDB_PA1_CFG9
.set DATA__4__PC, CYREG_PRT1_PC
.set DATA__4__PC2, CYREG_PRT1_PC2
.set DATA__4__PORT, 1
.set DATA__4__PS, CYREG_PRT1_PS
.set DATA__4__SHIFT, 4
.set DATA__5__DM__MASK, 0x38000
.set DATA__5__DM__SHIFT, 15
.set DATA__5__DR, CYREG_PRT1_DR
.set DATA__5__HSIOM, CYREG_HSIOM_PORT_SEL1
.set DATA__5__HSIOM_MASK, 0x00F00000
.set DATA__5__HSIOM_SHIFT, 20
.set DATA__5__INTCFG, CYREG_PRT1_INTCFG
.set DATA__5__INTSTAT, CYREG_PRT1_INTSTAT
.set DATA__5__MASK, 0x20
.set DATA__5__PA__CFG0, CYREG_UDB_PA1_CFG0
.set DATA__5__PA__CFG1, CYREG_UDB_PA1_CFG1
.set DATA__5__PA__CFG10, CYREG_UDB_PA1_CFG10
.set DATA__5__PA__CFG11, CYREG_UDB_PA1_CFG11
.set DATA__5__PA__CFG12, CYREG_UDB_PA1_CFG12
.set DATA__5__PA__CFG13, CYREG_UDB_PA1_CFG13
.set DATA__5__PA__CFG14, CYREG_UDB_PA1_CFG14
.set DATA__5__PA__CFG2, CYREG_UDB_PA1_CFG2
.set DATA__5__PA__CFG3, CYREG_UDB_PA1_CFG3
.set DATA__5__PA__CFG4, CYREG_UDB_PA1_CFG4
.set DATA__5__PA__CFG5, CYREG_UDB_PA1_CFG5
.set DATA__5__PA__CFG6, CYREG_UDB_PA1_CFG6
.set DATA__5__PA__CFG7, CYREG_UDB_PA1_CFG7
.set DATA__5__PA__CFG8, CYREG_UDB_PA1_CFG8
.set DATA__5__PA__CFG9, CYREG_UDB_PA1_CFG9
.set DATA__5__PC, CYREG_PRT1_PC
.set DATA__5__PC2, CYREG_PRT1_PC2
.set DATA__5__PORT, 1
.set DATA__5__PS, CYREG_PRT1_PS
.set DATA__5__SHIFT, 5
.set DATA__6__DM__MASK, 0x1C0000
.set DATA__6__DM__SHIFT, 18
.set DATA__6__DR, CYREG_PRT1_DR
.set DATA__6__HSIOM, CYREG_HSIOM_PORT_SEL1
.set DATA__6__HSIOM_MASK, 0x0F000000
.set DATA__6__HSIOM_SHIFT, 24
.set DATA__6__INTCFG, CYREG_PRT1_INTCFG
.set DATA__6__INTSTAT, CYREG_PRT1_INTSTAT
.set DATA__6__MASK, 0x40
.set DATA__6__PA__CFG0, CYREG_UDB_PA1_CFG0
.set DATA__6__PA__CFG1, CYREG_UDB_PA1_CFG1
.set DATA__6__PA__CFG10, CYREG_UDB_PA1_CFG10
.set DATA__6__PA__CFG11, CYREG_UDB_PA1_CFG11
.set DATA__6__PA__CFG12, CYREG_UDB_PA1_CFG12
.set DATA__6__PA__CFG13, CYREG_UDB_PA1_CFG13
.set DATA__6__PA__CFG14, CYREG_UDB_PA1_CFG14
.set DATA__6__PA__CFG2, CYREG_UDB_PA1_CFG2
.set DATA__6__PA__CFG3, CYREG_UDB_PA1_CFG3
.set DATA__6__PA__CFG4, CYREG_UDB_PA1_CFG4
.set DATA__6__PA__CFG5, CYREG_UDB_PA1_CFG5
.set DATA__6__PA__CFG6, CYREG_UDB_PA1_CFG6
.set DATA__6__PA__CFG7, CYREG_UDB_PA1_CFG7
.set DATA__6__PA__CFG8, CYREG_UDB_PA1_CFG8
.set DATA__6__PA__CFG9, CYREG_UDB_PA1_CFG9
.set DATA__6__PC, CYREG_PRT1_PC
.set DATA__6__PC2, CYREG_PRT1_PC2
.set DATA__6__PORT, 1
.set DATA__6__PS, CYREG_PRT1_PS
.set DATA__6__SHIFT, 6
.set DATA__7__DM__MASK, 0xE00000
.set DATA__7__DM__SHIFT, 21
.set DATA__7__DR, CYREG_PRT1_DR
.set DATA__7__HSIOM, CYREG_HSIOM_PORT_SEL1
.set DATA__7__HSIOM_MASK, 0xF0000000
.set DATA__7__HSIOM_SHIFT, 28
.set DATA__7__INTCFG, CYREG_PRT1_INTCFG
.set DATA__7__INTSTAT, CYREG_PRT1_INTSTAT
.set DATA__7__MASK, 0x80
.set DATA__7__PA__CFG0, CYREG_UDB_PA1_CFG0
.set DATA__7__PA__CFG1, CYREG_UDB_PA1_CFG1
.set DATA__7__PA__CFG10, CYREG_UDB_PA1_CFG10
.set DATA__7__PA__CFG11, CYREG_UDB_PA1_CFG11
.set DATA__7__PA__CFG12, CYREG_UDB_PA1_CFG12
.set DATA__7__PA__CFG13, CYREG_UDB_PA1_CFG13
.set DATA__7__PA__CFG14, CYREG_UDB_PA1_CFG14
.set DATA__7__PA__CFG2, CYREG_UDB_PA1_CFG2
.set DATA__7__PA__CFG3, CYREG_UDB_PA1_CFG3
.set DATA__7__PA__CFG4, CYREG_UDB_PA1_CFG4
.set DATA__7__PA__CFG5, CYREG_UDB_PA1_CFG5
.set DATA__7__PA__CFG6, CYREG_UDB_PA1_CFG6
.set DATA__7__PA__CFG7, CYREG_UDB_PA1_CFG7
.set DATA__7__PA__CFG8, CYREG_UDB_PA1_CFG8
.set DATA__7__PA__CFG9, CYREG_UDB_PA1_CFG9
.set DATA__7__PC, CYREG_PRT1_PC
.set DATA__7__PC2, CYREG_PRT1_PC2
.set DATA__7__PORT, 1
.set DATA__7__PS, CYREG_PRT1_PS
.set DATA__7__SHIFT, 7
.set DATA__DR, CYREG_PRT1_DR
.set DATA__INTCFG, CYREG_PRT1_INTCFG
.set DATA__INTSTAT, CYREG_PRT1_INTSTAT
.set DATA__MASK, 0xFF
.set DATA__PA__CFG0, CYREG_UDB_PA1_CFG0
.set DATA__PA__CFG1, CYREG_UDB_PA1_CFG1
.set DATA__PA__CFG10, CYREG_UDB_PA1_CFG10
.set DATA__PA__CFG11, CYREG_UDB_PA1_CFG11
.set DATA__PA__CFG12, CYREG_UDB_PA1_CFG12
.set DATA__PA__CFG13, CYREG_UDB_PA1_CFG13
.set DATA__PA__CFG14, CYREG_UDB_PA1_CFG14
.set DATA__PA__CFG2, CYREG_UDB_PA1_CFG2
.set DATA__PA__CFG3, CYREG_UDB_PA1_CFG3
.set DATA__PA__CFG4, CYREG_UDB_PA1_CFG4
.set DATA__PA__CFG5, CYREG_UDB_PA1_CFG5
.set DATA__PA__CFG6, CYREG_UDB_PA1_CFG6
.set DATA__PA__CFG7, CYREG_UDB_PA1_CFG7
.set DATA__PA__CFG8, CYREG_UDB_PA1_CFG8
.set DATA__PA__CFG9, CYREG_UDB_PA1_CFG9
.set DATA__PC, CYREG_PRT1_PC
.set DATA__PC2, CYREG_PRT1_PC2
.set DATA__PORT, 1
.set DATA__PS, CYREG_PRT1_PS
.set DATA__SHIFT, 0

/* LCD_CS */
.set LCD_CS__0__DM__MASK, 0x1C0
.set LCD_CS__0__DM__SHIFT, 6
.set LCD_CS__0__DR, CYREG_PRT0_DR
.set LCD_CS__0__HSIOM, CYREG_HSIOM_PORT_SEL0
.set LCD_CS__0__HSIOM_MASK, 0x00000F00
.set LCD_CS__0__HSIOM_SHIFT, 8
.set LCD_CS__0__INTCFG, CYREG_PRT0_INTCFG
.set LCD_CS__0__INTSTAT, CYREG_PRT0_INTSTAT
.set LCD_CS__0__MASK, 0x04
.set LCD_CS__0__PA__CFG0, CYREG_UDB_PA0_CFG0
.set LCD_CS__0__PA__CFG1, CYREG_UDB_PA0_CFG1
.set LCD_CS__0__PA__CFG10, CYREG_UDB_PA0_CFG10
.set LCD_CS__0__PA__CFG11, CYREG_UDB_PA0_CFG11
.set LCD_CS__0__PA__CFG12, CYREG_UDB_PA0_CFG12
.set LCD_CS__0__PA__CFG13, CYREG_UDB_PA0_CFG13
.set LCD_CS__0__PA__CFG14, CYREG_UDB_PA0_CFG14
.set LCD_CS__0__PA__CFG2, CYREG_UDB_PA0_CFG2
.set LCD_CS__0__PA__CFG3, CYREG_UDB_PA0_CFG3
.set LCD_CS__0__PA__CFG4, CYREG_UDB_PA0_CFG4
.set LCD_CS__0__PA__CFG5, CYREG_UDB_PA0_CFG5
.set LCD_CS__0__PA__CFG6, CYREG_UDB_PA0_CFG6
.set LCD_CS__0__PA__CFG7, CYREG_UDB_PA0_CFG7
.set LCD_CS__0__PA__CFG8, CYREG_UDB_PA0_CFG8
.set LCD_CS__0__PA__CFG9, CYREG_UDB_PA0_CFG9
.set LCD_CS__0__PC, CYREG_PRT0_PC
.set LCD_CS__0__PC2, CYREG_PRT0_PC2
.set LCD_CS__0__PORT, 0
.set LCD_CS__0__PS, CYREG_PRT0_PS
.set LCD_CS__0__SHIFT, 2
.set LCD_CS__DR, CYREG_PRT0_DR
.set LCD_CS__INTCFG, CYREG_PRT0_INTCFG
.set LCD_CS__INTSTAT, CYREG_PRT0_INTSTAT
.set LCD_CS__MASK, 0x04
.set LCD_CS__PA__CFG0, CYREG_UDB_PA0_CFG0
.set LCD_CS__PA__CFG1, CYREG_UDB_PA0_CFG1
.set LCD_CS__PA__CFG10, CYREG_UDB_PA0_CFG10
.set LCD_CS__PA__CFG11, CYREG_UDB_PA0_CFG11
.set LCD_CS__PA__CFG12, CYREG_UDB_PA0_CFG12
.set LCD_CS__PA__CFG13, CYREG_UDB_PA0_CFG13
.set LCD_CS__PA__CFG14, CYREG_UDB_PA0_CFG14
.set LCD_CS__PA__CFG2, CYREG_UDB_PA0_CFG2
.set LCD_CS__PA__CFG3, CYREG_UDB_PA0_CFG3
.set LCD_CS__PA__CFG4, CYREG_UDB_PA0_CFG4
.set LCD_CS__PA__CFG5, CYREG_UDB_PA0_CFG5
.set LCD_CS__PA__CFG6, CYREG_UDB_PA0_CFG6
.set LCD_CS__PA__CFG7, CYREG_UDB_PA0_CFG7
.set LCD_CS__PA__CFG8, CYREG_UDB_PA0_CFG8
.set LCD_CS__PA__CFG9, CYREG_UDB_PA0_CFG9
.set LCD_CS__PC, CYREG_PRT0_PC
.set LCD_CS__PC2, CYREG_PRT0_PC2
.set LCD_CS__PORT, 0
.set LCD_CS__PS, CYREG_PRT0_PS
.set LCD_CS__SHIFT, 2

/* LCD_RD */
.set LCD_RD__0__DM__MASK, 0x7000
.set LCD_RD__0__DM__SHIFT, 12
.set LCD_RD__0__DR, CYREG_PRT0_DR
.set LCD_RD__0__HSIOM, CYREG_HSIOM_PORT_SEL0
.set LCD_RD__0__HSIOM_MASK, 0x000F0000
.set LCD_RD__0__HSIOM_SHIFT, 16
.set LCD_RD__0__INTCFG, CYREG_PRT0_INTCFG
.set LCD_RD__0__INTSTAT, CYREG_PRT0_INTSTAT
.set LCD_RD__0__MASK, 0x10
.set LCD_RD__0__PA__CFG0, CYREG_UDB_PA0_CFG0
.set LCD_RD__0__PA__CFG1, CYREG_UDB_PA0_CFG1
.set LCD_RD__0__PA__CFG10, CYREG_UDB_PA0_CFG10
.set LCD_RD__0__PA__CFG11, CYREG_UDB_PA0_CFG11
.set LCD_RD__0__PA__CFG12, CYREG_UDB_PA0_CFG12
.set LCD_RD__0__PA__CFG13, CYREG_UDB_PA0_CFG13
.set LCD_RD__0__PA__CFG14, CYREG_UDB_PA0_CFG14
.set LCD_RD__0__PA__CFG2, CYREG_UDB_PA0_CFG2
.set LCD_RD__0__PA__CFG3, CYREG_UDB_PA0_CFG3
.set LCD_RD__0__PA__CFG4, CYREG_UDB_PA0_CFG4
.set LCD_RD__0__PA__CFG5, CYREG_UDB_PA0_CFG5
.set LCD_RD__0__PA__CFG6, CYREG_UDB_PA0_CFG6
.set LCD_RD__0__PA__CFG7, CYREG_UDB_PA0_CFG7
.set LCD_RD__0__PA__CFG8, CYREG_UDB_PA0_CFG8
.set LCD_RD__0__PA__CFG9, CYREG_UDB_PA0_CFG9
.set LCD_RD__0__PC, CYREG_PRT0_PC
.set LCD_RD__0__PC2, CYREG_PRT0_PC2
.set LCD_RD__0__PORT, 0
.set LCD_RD__0__PS, CYREG_PRT0_PS
.set LCD_RD__0__SHIFT, 4
.set LCD_RD__DR, CYREG_PRT0_DR
.set LCD_RD__INTCFG, CYREG_PRT0_INTCFG
.set LCD_RD__INTSTAT, CYREG_PRT0_INTSTAT
.set LCD_RD__MASK, 0x10
.set LCD_RD__PA__CFG0, CYREG_UDB_PA0_CFG0
.set LCD_RD__PA__CFG1, CYREG_UDB_PA0_CFG1
.set LCD_RD__PA__CFG10, CYREG_UDB_PA0_CFG10
.set LCD_RD__PA__CFG11, CYREG_UDB_PA0_CFG11
.set LCD_RD__PA__CFG12, CYREG_UDB_PA0_CFG12
.set LCD_RD__PA__CFG13, CYREG_UDB_PA0_CFG13
.set LCD_RD__PA__CFG14, CYREG_UDB_PA0_CFG14
.set LCD_RD__PA__CFG2, CYREG_UDB_PA0_CFG2
.set LCD_RD__PA__CFG3, CYREG_UDB_PA0_CFG3
.set LCD_RD__PA__CFG4, CYREG_UDB_PA0_CFG4
.set LCD_RD__PA__CFG5, CYREG_UDB_PA0_CFG5
.set LCD_RD__PA__CFG6, CYREG_UDB_PA0_CFG6
.set LCD_RD__PA__CFG7, CYREG_UDB_PA0_CFG7
.set LCD_RD__PA__CFG8, CYREG_UDB_PA0_CFG8
.set LCD_RD__PA__CFG9, CYREG_UDB_PA0_CFG9
.set LCD_RD__PC, CYREG_PRT0_PC
.set LCD_RD__PC2, CYREG_PRT0_PC2
.set LCD_RD__PORT, 0
.set LCD_RD__PS, CYREG_PRT0_PS
.set LCD_RD__SHIFT, 4

/* LCD_RS */
.set LCD_RS_Sync_ctrl_reg__0__MASK, 0x01
.set LCD_RS_Sync_ctrl_reg__0__POS, 0
.set LCD_RS_Sync_ctrl_reg__16BIT_CONTROL_AUX_CTL_REG, CYREG_UDB_W16_ACTL_01
.set LCD_RS_Sync_ctrl_reg__16BIT_CONTROL_CONTROL_REG, CYREG_UDB_W16_CTL_01
.set LCD_RS_Sync_ctrl_reg__16BIT_CONTROL_COUNT_REG, CYREG_UDB_W16_CTL_01
.set LCD_RS_Sync_ctrl_reg__16BIT_COUNT_CONTROL_REG, CYREG_UDB_W16_CTL_01
.set LCD_RS_Sync_ctrl_reg__16BIT_COUNT_COUNT_REG, CYREG_UDB_W16_CTL_01
.set LCD_RS_Sync_ctrl_reg__16BIT_MASK_MASK_REG, CYREG_UDB_W16_MSK_01
.set LCD_RS_Sync_ctrl_reg__16BIT_MASK_PERIOD_REG, CYREG_UDB_W16_MSK_01
.set LCD_RS_Sync_ctrl_reg__16BIT_PERIOD_MASK_REG, CYREG_UDB_W16_MSK_01
.set LCD_RS_Sync_ctrl_reg__16BIT_PERIOD_PERIOD_REG, CYREG_UDB_W16_MSK_01
.set LCD_RS_Sync_ctrl_reg__CONTROL_AUX_CTL_REG, CYREG_UDB_W8_ACTL_01
.set LCD_RS_Sync_ctrl_reg__CONTROL_REG, CYREG_UDB_W8_CTL_01
.set LCD_RS_Sync_ctrl_reg__CONTROL_ST_REG, CYREG_UDB_CAT16_CTL_ST_01
.set LCD_RS_Sync_ctrl_reg__COUNT_REG, CYREG_UDB_W8_CTL_01
.set LCD_RS_Sync_ctrl_reg__COUNT_ST_REG, CYREG_UDB_CAT16_CTL_ST_01
.set LCD_RS_Sync_ctrl_reg__MASK, 0x01
.set LCD_RS_Sync_ctrl_reg__MASK_CTL_AUX_CTL_REG, CYREG_UDB_CAT16_ACTL_MSK_01
.set LCD_RS_Sync_ctrl_reg__PER_CTL_AUX_CTL_REG, CYREG_UDB_CAT16_ACTL_MSK_01
.set LCD_RS_Sync_ctrl_reg__PERIOD_REG, CYREG_UDB_W8_MSK_01

/* LCD_WR */
.set LCD_WR__0__DM__MASK, 0xE00
.set LCD_WR__0__DM__SHIFT, 9
.set LCD_WR__0__DR, CYREG_PRT0_DR
.set LCD_WR__0__HSIOM, CYREG_HSIOM_PORT_SEL0
.set LCD_WR__0__HSIOM_MASK, 0x0000F000
.set LCD_WR__0__HSIOM_SHIFT, 12
.set LCD_WR__0__INTCFG, CYREG_PRT0_INTCFG
.set LCD_WR__0__INTSTAT, CYREG_PRT0_INTSTAT
.set LCD_WR__0__MASK, 0x08
.set LCD_WR__0__PA__CFG0, CYREG_UDB_PA0_CFG0
.set LCD_WR__0__PA__CFG1, CYREG_UDB_PA0_CFG1
.set LCD_WR__0__PA__CFG10, CYREG_UDB_PA0_CFG10
.set LCD_WR__0__PA__CFG11, CYREG_UDB_PA0_CFG11
.set LCD_WR__0__PA__CFG12, CYREG_UDB_PA0_CFG12
.set LCD_WR__0__PA__CFG13, CYREG_UDB_PA0_CFG13
.set LCD_WR__0__PA__CFG14, CYREG_UDB_PA0_CFG14
.set LCD_WR__0__PA__CFG2, CYREG_UDB_PA0_CFG2
.set LCD_WR__0__PA__CFG3, CYREG_UDB_PA0_CFG3
.set LCD_WR__0__PA__CFG4, CYREG_UDB_PA0_CFG4
.set LCD_WR__0__PA__CFG5, CYREG_UDB_PA0_CFG5
.set LCD_WR__0__PA__CFG6, CYREG_UDB_PA0_CFG6
.set LCD_WR__0__PA__CFG7, CYREG_UDB_PA0_CFG7
.set LCD_WR__0__PA__CFG8, CYREG_UDB_PA0_CFG8
.set LCD_WR__0__PA__CFG9, CYREG_UDB_PA0_CFG9
.set LCD_WR__0__PC, CYREG_PRT0_PC
.set LCD_WR__0__PC2, CYREG_PRT0_PC2
.set LCD_WR__0__PORT, 0
.set LCD_WR__0__PS, CYREG_PRT0_PS
.set LCD_WR__0__SHIFT, 3
.set LCD_WR__DR, CYREG_PRT0_DR
.set LCD_WR__INTCFG, CYREG_PRT0_INTCFG
.set LCD_WR__INTSTAT, CYREG_PRT0_INTSTAT
.set LCD_WR__MASK, 0x08
.set LCD_WR__PA__CFG0, CYREG_UDB_PA0_CFG0
.set LCD_WR__PA__CFG1, CYREG_UDB_PA0_CFG1
.set LCD_WR__PA__CFG10, CYREG_UDB_PA0_CFG10
.set LCD_WR__PA__CFG11, CYREG_UDB_PA0_CFG11
.set LCD_WR__PA__CFG12, CYREG_UDB_PA0_CFG12
.set LCD_WR__PA__CFG13, CYREG_UDB_PA0_CFG13
.set LCD_WR__PA__CFG14, CYREG_UDB_PA0_CFG14
.set LCD_WR__PA__CFG2, CYREG_UDB_PA0_CFG2
.set LCD_WR__PA__CFG3, CYREG_UDB_PA0_CFG3
.set LCD_WR__PA__CFG4, CYREG_UDB_PA0_CFG4
.set LCD_WR__PA__CFG5, CYREG_UDB_PA0_CFG5
.set LCD_WR__PA__CFG6, CYREG_UDB_PA0_CFG6
.set LCD_WR__PA__CFG7, CYREG_UDB_PA0_CFG7
.set LCD_WR__PA__CFG8, CYREG_UDB_PA0_CFG8
.set LCD_WR__PA__CFG9, CYREG_UDB_PA0_CFG9
.set LCD_WR__PC, CYREG_PRT0_PC
.set LCD_WR__PC2, CYREG_PRT0_PC2
.set LCD_WR__PORT, 0
.set LCD_WR__PS, CYREG_PRT0_PS
.set LCD_WR__SHIFT, 3

/* LCD_RST */
.set LCD_RST__0__DM__MASK, 0x38
.set LCD_RST__0__DM__SHIFT, 3
.set LCD_RST__0__DR, CYREG_PRT0_DR
.set LCD_RST__0__HSIOM, CYREG_HSIOM_PORT_SEL0
.set LCD_RST__0__HSIOM_MASK, 0x000000F0
.set LCD_RST__0__HSIOM_SHIFT, 4
.set LCD_RST__0__INTCFG, CYREG_PRT0_INTCFG
.set LCD_RST__0__INTSTAT, CYREG_PRT0_INTSTAT
.set LCD_RST__0__MASK, 0x02
.set LCD_RST__0__PA__CFG0, CYREG_UDB_PA0_CFG0
.set LCD_RST__0__PA__CFG1, CYREG_UDB_PA0_CFG1
.set LCD_RST__0__PA__CFG10, CYREG_UDB_PA0_CFG10
.set LCD_RST__0__PA__CFG11, CYREG_UDB_PA0_CFG11
.set LCD_RST__0__PA__CFG12, CYREG_UDB_PA0_CFG12
.set LCD_RST__0__PA__CFG13, CYREG_UDB_PA0_CFG13
.set LCD_RST__0__PA__CFG14, CYREG_UDB_PA0_CFG14
.set LCD_RST__0__PA__CFG2, CYREG_UDB_PA0_CFG2
.set LCD_RST__0__PA__CFG3, CYREG_UDB_PA0_CFG3
.set LCD_RST__0__PA__CFG4, CYREG_UDB_PA0_CFG4
.set LCD_RST__0__PA__CFG5, CYREG_UDB_PA0_CFG5
.set LCD_RST__0__PA__CFG6, CYREG_UDB_PA0_CFG6
.set LCD_RST__0__PA__CFG7, CYREG_UDB_PA0_CFG7
.set LCD_RST__0__PA__CFG8, CYREG_UDB_PA0_CFG8
.set LCD_RST__0__PA__CFG9, CYREG_UDB_PA0_CFG9
.set LCD_RST__0__PC, CYREG_PRT0_PC
.set LCD_RST__0__PC2, CYREG_PRT0_PC2
.set LCD_RST__0__PORT, 0
.set LCD_RST__0__PS, CYREG_PRT0_PS
.set LCD_RST__0__SHIFT, 1
.set LCD_RST__DR, CYREG_PRT0_DR
.set LCD_RST__INTCFG, CYREG_PRT0_INTCFG
.set LCD_RST__INTSTAT, CYREG_PRT0_INTSTAT
.set LCD_RST__MASK, 0x02
.set LCD_RST__PA__CFG0, CYREG_UDB_PA0_CFG0
.set LCD_RST__PA__CFG1, CYREG_UDB_PA0_CFG1
.set LCD_RST__PA__CFG10, CYREG_UDB_PA0_CFG10
.set LCD_RST__PA__CFG11, CYREG_UDB_PA0_CFG11
.set LCD_RST__PA__CFG12, CYREG_UDB_PA0_CFG12
.set LCD_RST__PA__CFG13, CYREG_UDB_PA0_CFG13
.set LCD_RST__PA__CFG14, CYREG_UDB_PA0_CFG14
.set LCD_RST__PA__CFG2, CYREG_UDB_PA0_CFG2
.set LCD_RST__PA__CFG3, CYREG_UDB_PA0_CFG3
.set LCD_RST__PA__CFG4, CYREG_UDB_PA0_CFG4
.set LCD_RST__PA__CFG5, CYREG_UDB_PA0_CFG5
.set LCD_RST__PA__CFG6, CYREG_UDB_PA0_CFG6
.set LCD_RST__PA__CFG7, CYREG_UDB_PA0_CFG7
.set LCD_RST__PA__CFG8, CYREG_UDB_PA0_CFG8
.set LCD_RST__PA__CFG9, CYREG_UDB_PA0_CFG9
.set LCD_RST__PC, CYREG_PRT0_PC
.set LCD_RST__PC2, CYREG_PRT0_PC2
.set LCD_RST__PORT, 0
.set LCD_RST__PS, CYREG_PRT0_PS
.set LCD_RST__SHIFT, 1

/* DDR_DATA */
.set DDR_DATA_Sync_ctrl_reg__0__MASK, 0x01
.set DDR_DATA_Sync_ctrl_reg__0__POS, 0
.set DDR_DATA_Sync_ctrl_reg__CONTROL_AUX_CTL_REG, CYREG_UDB_W8_ACTL_03
.set DDR_DATA_Sync_ctrl_reg__CONTROL_REG, CYREG_UDB_W8_CTL_03
.set DDR_DATA_Sync_ctrl_reg__CONTROL_ST_REG, CYREG_UDB_CAT16_CTL_ST_03
.set DDR_DATA_Sync_ctrl_reg__COUNT_REG, CYREG_UDB_W8_CTL_03
.set DDR_DATA_Sync_ctrl_reg__COUNT_ST_REG, CYREG_UDB_CAT16_CTL_ST_03
.set DDR_DATA_Sync_ctrl_reg__MASK, 0x01
.set DDR_DATA_Sync_ctrl_reg__MASK_CTL_AUX_CTL_REG, CYREG_UDB_CAT16_ACTL_MSK_03
.set DDR_DATA_Sync_ctrl_reg__PER_CTL_AUX_CTL_REG, CYREG_UDB_CAT16_ACTL_MSK_03
.set DDR_DATA_Sync_ctrl_reg__PERIOD_REG, CYREG_UDB_W8_MSK_03

/* Read_enable */
.set Read_enable_Sync_ctrl_reg__0__MASK, 0x01
.set Read_enable_Sync_ctrl_reg__0__POS, 0
.set Read_enable_Sync_ctrl_reg__16BIT_CONTROL_AUX_CTL_REG, CYREG_UDB_W16_ACTL_02
.set Read_enable_Sync_ctrl_reg__16BIT_CONTROL_CONTROL_REG, CYREG_UDB_W16_CTL_02
.set Read_enable_Sync_ctrl_reg__16BIT_CONTROL_COUNT_REG, CYREG_UDB_W16_CTL_02
.set Read_enable_Sync_ctrl_reg__16BIT_COUNT_CONTROL_REG, CYREG_UDB_W16_CTL_02
.set Read_enable_Sync_ctrl_reg__16BIT_COUNT_COUNT_REG, CYREG_UDB_W16_CTL_02
.set Read_enable_Sync_ctrl_reg__16BIT_MASK_MASK_REG, CYREG_UDB_W16_MSK_02
.set Read_enable_Sync_ctrl_reg__16BIT_MASK_PERIOD_REG, CYREG_UDB_W16_MSK_02
.set Read_enable_Sync_ctrl_reg__16BIT_PERIOD_MASK_REG, CYREG_UDB_W16_MSK_02
.set Read_enable_Sync_ctrl_reg__16BIT_PERIOD_PERIOD_REG, CYREG_UDB_W16_MSK_02
.set Read_enable_Sync_ctrl_reg__CONTROL_AUX_CTL_REG, CYREG_UDB_W8_ACTL_02
.set Read_enable_Sync_ctrl_reg__CONTROL_REG, CYREG_UDB_W8_CTL_02
.set Read_enable_Sync_ctrl_reg__CONTROL_ST_REG, CYREG_UDB_CAT16_CTL_ST_02
.set Read_enable_Sync_ctrl_reg__COUNT_REG, CYREG_UDB_W8_CTL_02
.set Read_enable_Sync_ctrl_reg__COUNT_ST_REG, CYREG_UDB_CAT16_CTL_ST_02
.set Read_enable_Sync_ctrl_reg__MASK, 0x01
.set Read_enable_Sync_ctrl_reg__MASK_CTL_AUX_CTL_REG, CYREG_UDB_CAT16_ACTL_MSK_02
.set Read_enable_Sync_ctrl_reg__PER_CTL_AUX_CTL_REG, CYREG_UDB_CAT16_ACTL_MSK_02
.set Read_enable_Sync_ctrl_reg__PERIOD_REG, CYREG_UDB_W8_MSK_02

/* LCD_protected_RS */
.set LCD_protected_RS__0__DM__MASK, 0x07
.set LCD_protected_RS__0__DM__SHIFT, 0
.set LCD_protected_RS__0__DR, CYREG_PRT0_DR
.set LCD_protected_RS__0__HSIOM, CYREG_HSIOM_PORT_SEL0
.set LCD_protected_RS__0__HSIOM_MASK, 0x0000000F
.set LCD_protected_RS__0__HSIOM_SHIFT, 0
.set LCD_protected_RS__0__INTCFG, CYREG_PRT0_INTCFG
.set LCD_protected_RS__0__INTSTAT, CYREG_PRT0_INTSTAT
.set LCD_protected_RS__0__MASK, 0x01
.set LCD_protected_RS__0__OUT_SEL, CYREG_UDB_PA0_CFG10
.set LCD_protected_RS__0__OUT_SEL_SHIFT, 0
.set LCD_protected_RS__0__OUT_SEL_VAL, 1
.set LCD_protected_RS__0__PA__CFG0, CYREG_UDB_PA0_CFG0
.set LCD_protected_RS__0__PA__CFG1, CYREG_UDB_PA0_CFG1
.set LCD_protected_RS__0__PA__CFG10, CYREG_UDB_PA0_CFG10
.set LCD_protected_RS__0__PA__CFG11, CYREG_UDB_PA0_CFG11
.set LCD_protected_RS__0__PA__CFG12, CYREG_UDB_PA0_CFG12
.set LCD_protected_RS__0__PA__CFG13, CYREG_UDB_PA0_CFG13
.set LCD_protected_RS__0__PA__CFG14, CYREG_UDB_PA0_CFG14
.set LCD_protected_RS__0__PA__CFG2, CYREG_UDB_PA0_CFG2
.set LCD_protected_RS__0__PA__CFG3, CYREG_UDB_PA0_CFG3
.set LCD_protected_RS__0__PA__CFG4, CYREG_UDB_PA0_CFG4
.set LCD_protected_RS__0__PA__CFG5, CYREG_UDB_PA0_CFG5
.set LCD_protected_RS__0__PA__CFG6, CYREG_UDB_PA0_CFG6
.set LCD_protected_RS__0__PA__CFG7, CYREG_UDB_PA0_CFG7
.set LCD_protected_RS__0__PA__CFG8, CYREG_UDB_PA0_CFG8
.set LCD_protected_RS__0__PA__CFG9, CYREG_UDB_PA0_CFG9
.set LCD_protected_RS__0__PC, CYREG_PRT0_PC
.set LCD_protected_RS__0__PC2, CYREG_PRT0_PC2
.set LCD_protected_RS__0__PORT, 0
.set LCD_protected_RS__0__PS, CYREG_PRT0_PS
.set LCD_protected_RS__0__SHIFT, 0
.set LCD_protected_RS__DR, CYREG_PRT0_DR
.set LCD_protected_RS__INTCFG, CYREG_PRT0_INTCFG
.set LCD_protected_RS__INTSTAT, CYREG_PRT0_INTSTAT
.set LCD_protected_RS__MASK, 0x01
.set LCD_protected_RS__PA__CFG0, CYREG_UDB_PA0_CFG0
.set LCD_protected_RS__PA__CFG1, CYREG_UDB_PA0_CFG1
.set LCD_protected_RS__PA__CFG10, CYREG_UDB_PA0_CFG10
.set LCD_protected_RS__PA__CFG11, CYREG_UDB_PA0_CFG11
.set LCD_protected_RS__PA__CFG12, CYREG_UDB_PA0_CFG12
.set LCD_protected_RS__PA__CFG13, CYREG_UDB_PA0_CFG13
.set LCD_protected_RS__PA__CFG14, CYREG_UDB_PA0_CFG14
.set LCD_protected_RS__PA__CFG2, CYREG_UDB_PA0_CFG2
.set LCD_protected_RS__PA__CFG3, CYREG_UDB_PA0_CFG3
.set LCD_protected_RS__PA__CFG4, CYREG_UDB_PA0_CFG4
.set LCD_protected_RS__PA__CFG5, CYREG_UDB_PA0_CFG5
.set LCD_protected_RS__PA__CFG6, CYREG_UDB_PA0_CFG6
.set LCD_protected_RS__PA__CFG7, CYREG_UDB_PA0_CFG7
.set LCD_protected_RS__PA__CFG8, CYREG_UDB_PA0_CFG8
.set LCD_protected_RS__PA__CFG9, CYREG_UDB_PA0_CFG9
.set LCD_protected_RS__PC, CYREG_PRT0_PC
.set LCD_protected_RS__PC2, CYREG_PRT0_PC2
.set LCD_protected_RS__PORT, 0
.set LCD_protected_RS__PS, CYREG_PRT0_PS
.set LCD_protected_RS__SHIFT, 0

/* Miscellaneous */
.set CYDEV_BCLK__HFCLK__HZ, 24000000
.set CYDEV_BCLK__HFCLK__KHZ, 24000
.set CYDEV_BCLK__HFCLK__MHZ, 24
.set CYDEV_BCLK__SYSCLK__HZ, 24000000
.set CYDEV_BCLK__SYSCLK__KHZ, 24000
.set CYDEV_BCLK__SYSCLK__MHZ, 24
.set CYDEV_CHIP_DIE_LEOPARD, 1
.set CYDEV_CHIP_DIE_PSOC4A, 12
.set CYDEV_CHIP_DIE_PSOC5LP, 19
.set CYDEV_CHIP_DIE_PSOC5TM, 20
.set CYDEV_CHIP_DIE_TMA4, 2
.set CYDEV_CHIP_DIE_UNKNOWN, 0
.set CYDEV_CHIP_FAMILY_FM0P, 4
.set CYDEV_CHIP_FAMILY_FM3, 5
.set CYDEV_CHIP_FAMILY_FM4, 6
.set CYDEV_CHIP_FAMILY_PSOC3, 1
.set CYDEV_CHIP_FAMILY_PSOC4, 2
.set CYDEV_CHIP_FAMILY_PSOC5, 3
.set CYDEV_CHIP_FAMILY_UNKNOWN, 0
.set CYDEV_CHIP_FAMILY_USED, CYDEV_CHIP_FAMILY_PSOC4
.set CYDEV_CHIP_JTAG_ID, 0x04C81193
.set CYDEV_CHIP_MEMBER_3A, 1
.set CYDEV_CHIP_MEMBER_4A, 12
.set CYDEV_CHIP_MEMBER_4C, 18
.set CYDEV_CHIP_MEMBER_4D, 8
.set CYDEV_CHIP_MEMBER_4E, 4
.set CYDEV_CHIP_MEMBER_4F, 13
.set CYDEV_CHIP_MEMBER_4G, 2
.set CYDEV_CHIP_MEMBER_4H, 11
.set CYDEV_CHIP_MEMBER_4I, 17
.set CYDEV_CHIP_MEMBER_4J, 9
.set CYDEV_CHIP_MEMBER_4K, 10
.set CYDEV_CHIP_MEMBER_4L, 16
.set CYDEV_CHIP_MEMBER_4M, 15
.set CYDEV_CHIP_MEMBER_4N, 6
.set CYDEV_CHIP_MEMBER_4O, 5
.set CYDEV_CHIP_MEMBER_4P, 14
.set CYDEV_CHIP_MEMBER_4Q, 7
.set CYDEV_CHIP_MEMBER_4U, 3
.set CYDEV_CHIP_MEMBER_5A, 20
.set CYDEV_CHIP_MEMBER_5B, 19
.set CYDEV_CHIP_MEMBER_FM3, 24
.set CYDEV_CHIP_MEMBER_FM4, 25
.set CYDEV_CHIP_MEMBER_PDL_FM0P_TYPE1, 21
.set CYDEV_CHIP_MEMBER_PDL_FM0P_TYPE2, 22
.set CYDEV_CHIP_MEMBER_PDL_FM0P_TYPE3, 23
.set CYDEV_CHIP_MEMBER_UNKNOWN, 0
.set CYDEV_CHIP_MEMBER_USED, CYDEV_CHIP_MEMBER_4A
.set CYDEV_CHIP_DIE_EXPECT, CYDEV_CHIP_MEMBER_USED
.set CYDEV_CHIP_DIE_ACTUAL, CYDEV_CHIP_DIE_EXPECT
.set CYDEV_CHIP_REV_LEOPARD_ES1, 0
.set CYDEV_CHIP_REV_LEOPARD_ES2, 1
.set CYDEV_CHIP_REV_LEOPARD_ES3, 3
.set CYDEV_CHIP_REV_LEOPARD_PRODUCTION, 3
.set CYDEV_CHIP_REV_PSOC4A_ES0, 17
.set CYDEV_CHIP_REV_PSOC4A_PRODUCTION, 17
.set CYDEV_CHIP_REV_PSOC5LP_ES0, 0
.set CYDEV_CHIP_REV_PSOC5LP_PRODUCTION, 0
.set CYDEV_CHIP_REV_PSOC5TM_ES0, 0
.set CYDEV_CHIP_REV_PSOC5TM_ES1, 1
.set CYDEV_CHIP_REV_PSOC5TM_PRODUCTION, 1
.set CYDEV_CHIP_REV_TMA4_ES, 17
.set CYDEV_CHIP_REV_TMA4_ES2, 33
.set CYDEV_CHIP_REV_TMA4_PRODUCTION, 17
.set CYDEV_CHIP_REVISION_3A_ES1, 0
.set CYDEV_CHIP_REVISION_3A_ES2, 1
.set CYDEV_CHIP_REVISION_3A_ES3, 3
.set CYDEV_CHIP_REVISION_3A_PRODUCTION, 3
.set CYDEV_CHIP_REVISION_4A_ES0, 17
.set CYDEV_CHIP_REVISION_4A_PRODUCTION, 17
.set CYDEV_CHIP_REVISION_4C_PRODUCTION, 0
.set CYDEV_CHIP_REVISION_4D_PRODUCTION, 0
.set CYDEV_CHIP_REVISION_4E_PRODUCTION, 0
.set CYDEV_CHIP_REVISION_4F_PRODUCTION, 0
.set CYDEV_CHIP_REVISION_4F_PRODUCTION_256DMA, 0
.set CYDEV_CHIP_REVISION_4F_PRODUCTION_256K, 0
.set CYDEV_CHIP_REVISION_4G_ES, 17
.set CYDEV_CHIP_REVISION_4G_ES2, 33
.set CYDEV_CHIP_REVISION_4G_PRODUCTION, 17
.set CYDEV_CHIP_REVISION_4H_PRODUCTION, 0
.set CYDEV_CHIP_REVISION_4I_PRODUCTION, 0
.set CYDEV_CHIP_REVISION_4J_PRODUCTION, 0
.set CYDEV_CHIP_REVISION_4K_PRODUCTION, 0
.set CYDEV_CHIP_REVISION_4L_PRODUCTION, 0
.set CYDEV_CHIP_REVISION_4M_PRODUCTION, 0
.set CYDEV_CHIP_REVISION_4N_PRODUCTION, 0
.set CYDEV_CHIP_REVISION_4O_PRODUCTION, 0
.set CYDEV_CHIP_REVISION_4P_PRODUCTION, 0
.set CYDEV_CHIP_REVISION_4Q_PRODUCTION, 0
.set CYDEV_CHIP_REVISION_4U_PRODUCTION, 0
.set CYDEV_CHIP_REVISION_5A_ES0, 0
.set CYDEV_CHIP_REVISION_5A_ES1, 1
.set CYDEV_CHIP_REVISION_5A_PRODUCTION, 1
.set CYDEV_CHIP_REVISION_5B_ES0, 0
.set CYDEV_CHIP_REVISION_5B_PRODUCTION, 0
.set CYDEV_CHIP_REVISION_FM3_PRODUCTION, 0
.set CYDEV_CHIP_REVISION_FM4_PRODUCTION, 0
.set CYDEV_CHIP_REVISION_PDL_FM0P_TYPE1_PRODUCTION, 0
.set CYDEV_CHIP_REVISION_PDL_FM0P_TYPE2_PRODUCTION, 0
.set CYDEV_CHIP_REVISION_PDL_FM0P_TYPE3_PRODUCTION, 0
.set CYDEV_CHIP_REVISION_USED, CYDEV_CHIP_REVISION_4A_PRODUCTION
.set CYDEV_CHIP_REV_EXPECT, CYDEV_CHIP_REVISION_USED
.set CYDEV_CONFIG_READ_ACCELERATOR, 1
.set CYDEV_CONFIG_UNUSED_IO_AllowButWarn, 0
.set CYDEV_CONFIG_UNUSED_IO_AllowWithInfo, 1
.set CYDEV_CONFIG_UNUSED_IO_Disallowed, 2
.set CYDEV_CONFIG_UNUSED_IO, CYDEV_CONFIG_UNUSED_IO_Disallowed
.set CYDEV_CONFIGURATION_COMPRESSED, 1
.set CYDEV_CONFIGURATION_MODE_COMPRESSED, 0
.set CYDEV_CONFIGURATION_MODE, CYDEV_CONFIGURATION_MODE_COMPRESSED
.set CYDEV_CONFIGURATION_MODE_DMA, 2
.set CYDEV_CONFIGURATION_MODE_UNCOMPRESSED, 1
.set CYDEV_DEBUG_PROTECT_KILL, 4
.set CYDEV_DEBUG_PROTECT_OPEN, 1
.set CYDEV_DEBUG_PROTECT, CYDEV_DEBUG_PROTECT_OPEN
.set CYDEV_DEBUG_PROTECT_PROTECTED, 2
.set CYDEV_DEBUGGING_DPS_Disable, 3
.set CYDEV_DEBUGGING_DPS_SWD, 2
.set CYDEV_DEBUGGING_DPS, CYDEV_DEBUGGING_DPS_SWD
.set CYDEV_DEBUGGING_ENABLE, 1
.set CYDEV_DFT_SELECT_CLK0, 1
.set CYDEV_DFT_SELECT_CLK1, 2
.set CYDEV_HEAP_SIZE, 0x80
.set CYDEV_IMO_TRIMMED_BY_USB, 0
.set CYDEV_IMO_TRIMMED_BY_WCO, 0
.set CYDEV_IS_EXPORTING_CODE, 0
.set CYDEV_IS_IMPORTING_CODE, 0
.set CYDEV_PROJ_TYPE, 0
.set CYDEV_PROJ_TYPE_BOOTLOADER, 1
.set CYDEV_PROJ_TYPE_LAUNCHER, 5
.set CYDEV_PROJ_TYPE_LOADABLE, 2
.set CYDEV_PROJ_TYPE_LOADABLEANDBOOTLOADER, 4
.set CYDEV_PROJ_TYPE_MULTIAPPBOOTLOADER, 3
.set CYDEV_PROJ_TYPE_STANDARD, 0
.set CYDEV_STACK_SIZE, 0x0400
.set CYDEV_USE_BUNDLED_CMSIS, 1
.set CYDEV_VARIABLE_VDDA, 1
.set CYDEV_VDDA_MV, 3300
.set CYDEV_VDDD_MV, 3300
.set CYDEV_WDT_GENERATE_ISR, 1
.set CYIPBLOCK_M0S8_CTBM_VERSION, 0
.set CYIPBLOCK_m0s8cpuss_VERSION, 0
.set CYIPBLOCK_m0s8csd_VERSION, 0
.set CYIPBLOCK_m0s8gpio2_VERSION, 0
.set CYIPBLOCK_m0s8hsiom4a_VERSION, 0
.set CYIPBLOCK_m0s8lcd_VERSION, 0
.set CYIPBLOCK_m0s8lpcomp_VERSION, 0
.set CYIPBLOCK_m0s8pclk_VERSION, 0
.set CYIPBLOCK_m0s8sar_VERSION, 0
.set CYIPBLOCK_m0s8scb_VERSION, 0
.set CYIPBLOCK_m0s8srssv2_VERSION, 1
.set CYIPBLOCK_m0s8tcpwm_VERSION, 0
.set CYIPBLOCK_m0s8udbif_VERSION, 0
.set CYIPBLOCK_S8_GPIO_VERSION, 2
.set CYDEV_BOOTLOADER_ENABLE, 0
.endif
