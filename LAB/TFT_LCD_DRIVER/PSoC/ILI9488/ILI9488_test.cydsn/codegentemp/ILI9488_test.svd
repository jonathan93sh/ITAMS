# CY8C4245AXI_483 register map
File version: 0.1
PSoC 4200
Registers are 8-bit, read-write, no defined reset value unless marked. A register's access mark holds for its fields unless they carry their own. Offsets are from the block's base; lines under a group give offsets from that group; [hi:lo] are bit positions; {n}, {i} and the like mark numbered series; 'fields as' and 'values as' point back to an identical list; <NAME> marks a mode.

## Memory map
0x400F0071 LCD_RS
0x400F0072 Read_enable
0x400F0073 DDR_DATA

## LCD_RS
Base 0x400F0071
0x00 LCD_RS_CONTROL_REG

## Read_enable
Base 0x400F0072
Registers as LCD_RS (with LCD_RS read as Read_enable).

## DDR_DATA
Base 0x400F0073
Registers as LCD_RS (with LCD_RS read as DDR_DATA).
